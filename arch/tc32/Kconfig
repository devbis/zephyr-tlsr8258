## arch/tc32/Kconfig
```kconfig
# SPDX-License-Identifier: Apache-2.0

menu "TC32 Options"
	depends on TC32

config ARCH
	string
	default "tc32"

config GEN_ISR_TABLES
	default y

config GEN_IRQ_VECTOR_TABLE
	default n

config GEN_SW_ISR_TABLE
	default y

config ARCH_HAS_SINGLE_THREAD_SUPPORT
	default y if !SMP

config TC32_BOOT_MIRROR_SIZE
	hex "TC32 boot mirror SRAM reserve size"
	default 0x4000
	help
	  Size of the low SRAM window reserved for the TLSR boot-ROM flash
	  mirror. Larger Zephyr images need a larger mirror because the boot
	  header asks the ROM to copy the image LMA prefix into SRAM before the
	  TC32 runtime copies RAM data sections to their final addresses.

endmenu
```

## boards/aithinker/pb_03f/Kconfig.pb_03f
```kconfig
# SPDX-FileCopyrightText: Copyright The Zephyr Project Contributors
# SPDX-License-Identifier: Apache-2.0

config BOARD_PB_03F
	select SOC_PHY6252
```

## boards/aithinker/pb_03f/board.yml
```yaml
board:
  name: pb_03f
  full_name: Ai-Thinker PB-03F
  vendor: aithinker
  socs:
    - name: phy6252
```

## boards/aithinker/pb_03f/pb_03f_defconfig
```kconfig
# SPDX-FileCopyrightText: Copyright The Zephyr Project Contributors
# SPDX-License-Identifier: Apache-2.0

CONFIG_MAIN_STACK_SIZE=1024
CONFIG_SERIAL=y
CONFIG_CONSOLE=y
CONFIG_UART_CONSOLE=y
CONFIG_UART_NS16550=y
CONFIG_UART_NS16550_ACCESS_WORD_ONLY=y
CONFIG_UART_INTERRUPT_DRIVEN=y
```

## boards/chinalctech/ecb02c/Kconfig.ecb02c
```kconfig
# SPDX-FileCopyrightText: Copyright The Zephyr Project Contributors
# SPDX-License-Identifier: Apache-2.0

config BOARD_ECB02C
	select SOC_PHY6252
```

## boards/chinalctech/ecb02c/board.yml
```yaml
board:
  name: ecb02c
  full_name: ChinaLCTech ECB02C
  vendor: chinalctech
  socs:
    - name: phy6252
```

## boards/native/nrf_bsim/nrf52_bsim_64_defconfig
```kconfig
# Copyright (c) 2026 Zephyr Project Contributors
# SPDX-License-Identifier: Apache-2.0

CONFIG_CONSOLE=y
CONFIG_NO_OPTIMIZATIONS=y
```

## boards/telink/tlsr8258_generic/board.yml
```yaml
# SPDX-FileCopyrightText: Copyright The Zephyr Project Contributors
# SPDX-License-Identifier: Apache-2.0

board:
  name: tlsr8258_generic
  full_name: TLSR8258 Generic
  vendor: telink
  socs:
  - name: tlsr8258
```

## boards/telink/tlsr8258_generic/tlsr8258_generic_defconfig
```kconfig
# SPDX-License-Identifier: Apache-2.0

CONFIG_CONSOLE=n
CONFIG_SERIAL=n
CONFIG_BOOT_BANNER=n
CONFIG_PRINTK=n
CONFIG_CBPRINTF_NANO=y
CONFIG_LLVM_USE_LLD=y
```

## boards/telink/tlsr8258_generic_1m/Kconfig.defconfig
```kconfig
# SPDX-FileCopyrightText: Copyright The Zephyr Project Contributors
# SPDX-License-Identifier: Apache-2.0

if BOARD_TLSR8258_GENERIC_1M

# Workaround for not being able to have commas in macro arguments
DT_CHOSEN_Z_CODE_PARTITION := zephyr,code-partition
DT_CHOSEN_Z_FLASH := zephyr,flash

config FLASH_SIZE
	default $(dt_chosen_reg_size_int,$(DT_CHOSEN_Z_FLASH),0,K)

config FLASH_LOAD_OFFSET
	default $(dt_chosen_reg_addr_hex,$(DT_CHOSEN_Z_CODE_PARTITION)) if USE_DT_CODE_PARTITION

config FLASH_LOAD_SIZE
	default $(dt_chosen_reg_size_hex,$(DT_CHOSEN_Z_CODE_PARTITION)) if USE_DT_CODE_PARTITION

config IMG_BLOCK_BUF_SIZE
	default 256 if MCUBOOT_IMG_MANAGER

endif
```

## boards/telink/tlsr8258_generic_1m/board.yml
```yaml
# SPDX-FileCopyrightText: Copyright The Zephyr Project Contributors
# SPDX-License-Identifier: Apache-2.0

board:
  name: tlsr8258_generic_1m
  full_name: TLSR8258 Generic 1 MB
  vendor: telink
  socs:
  - name: tlsr8258
```

## boards/telink/tlsr8258_tb03f/Kconfig.tlsr8258_tb03f
```kconfig
# SPDX-License-Identifier: Apache-2.0

config BOARD_TLSR8258_TB03F
	select SOC_TLSR8258
```

## boards/telink/tlsr8258_tb03f/board.yml
```yaml
# SPDX-FileCopyrightText: Copyright The Zephyr Project Contributors
# SPDX-License-Identifier: Apache-2.0

board:
  name: tlsr8258_tb03f
  full_name: Telink TLSR8258 TB03F
  vendor: telink
  socs:
  - name: tlsr8258
```

## boards/telink/tlsr8269_generic/Kconfig.tlsr8269_generic
```kconfig
# SPDX-FileCopyrightText: Copyright The Zephyr Project Contributors
# SPDX-License-Identifier: Apache-2.0

config BOARD_TLSR8269_GENERIC
	select SOC_TLSR8269
```

## boards/telink/tlsr8269_generic/board.yml
```yaml
# SPDX-FileCopyrightText: Copyright The Zephyr Project Contributors
# SPDX-License-Identifier: Apache-2.0

board:
  name: tlsr8269_generic
  full_name: TLSR8269 Generic
  vendor: telink
  socs:
  - name: tlsr8269
```

## boards/telink/tlsr8269_generic/tlsr8269_generic_defconfig
```kconfig
# SPDX-FileCopyrightText: Copyright The Zephyr Project Contributors
# SPDX-License-Identifier: Apache-2.0

CONFIG_LLVM_USE_LLD=y
```

## drivers/adc/Kconfig.tlsr8258
```kconfig
# SPDX-FileCopyrightText: Copyright The Zephyr Project Contributors
# SPDX-License-Identifier: Apache-2.0

config ADC_TLSR8258
	bool "Telink TLSR8258 ADC driver"
	default y
	depends on DT_HAS_TELINK_TLSR8258_ADC_ENABLED
	select ADC_CONFIGURABLE_INPUTS
	help
	  Enable the on-chip SAR ADC of the TLSR8258. Each channel samples one
	  GPIO (PB0..PB7, PC4, PC5) either as a base-mode input or in VBAT mode.
```

## drivers/counter/Kconfig.tlsr8258
```kconfig
# SPDX-FileCopyrightText: Copyright The Zephyr Project Contributors
# SPDX-License-Identifier: Apache-2.0

config COUNTER_TLSR8258
	bool "Telink TLSR8258 hardware timer counter driver"
	default y
	depends on SOC_SERIES_TLSR825X || SOC_SERIES_TLSR826X
	depends on DT_HAS_TELINK_TLSR8258_TIMER_ENABLED
	help
	  Enable the counter API for the TLSR8258 hardware timers 0, 1 and 2.
	  Timer 2 conflicts with the watchdog and timer 0 with IRQ offload.
```

## drivers/crypto/Kconfig.telink
```kconfig
# SPDX-FileCopyrightText: Copyright The Zephyr Project Contributors
# SPDX-License-Identifier: Apache-2.0

config CRYPTO_TLSR8258
	bool "Telink TLSR8258 AES accelerator"
	default y
	depends on DT_HAS_TELINK_TLSR8258_AES_ENABLED
	help
	  Enable the driver for the AES-128 block engine of the Telink
	  TLSR8258. The engine performs a single ECB block per run in both
	  directions; chained modes have to be built on top of it.

config CRYPTO_TLSR8258_MAX_SESSION
	int "Maximum number of concurrent TLSR8258 AES sessions"
	default 2
	range 1 8
	depends on CRYPTO_TLSR8258
	help
	  Number of cipher contexts the driver can keep open at once. The
	  engine holds no per-session state of its own, so each session only
	  costs a cached key.
```

## drivers/entropy/Kconfig.tlsr8258
```kconfig
# SPDX-FileCopyrightText: Copyright The Zephyr Project Contributors
# SPDX-License-Identifier: Apache-2.0

config ENTROPY_TLSR8258_RNG
	bool "Telink TLSR8258 ADC noise entropy driver"
	default y
	depends on DT_HAS_TELINK_TLSR8258_RNG_ENABLED
	select ENTROPY_HAS_DRIVER
	select ENTROPY_NEEDS_PRNG
	help
	  Enable the entropy driver of the TLSR8258. It conditions the noise of
	  the SAR ADC and shares the converter with the ADC driver, so
	  entropy_get_entropy() is slow: the random generator takes a seed from
	  it and does not ask it again.
```

## drivers/flash/Kconfig.phy6252
```kconfig
# SPDX-FileCopyrightText: Copyright The Zephyr Project Contributors
# SPDX-License-Identifier: Apache-2.0

config FLASH_PHY6252
	bool "PHY6252 flash controller"
	default y
	depends on DT_HAS_PHYPLUS_PHY6252_FLASH_CONTROLLER_ENABLED
	select FLASH_HAS_DRIVER_ENABLED
	select FLASH_HAS_PAGE_LAYOUT
	select FLASH_HAS_EXPLICIT_ERASE
	help
	  Enable the PHY6252 flash controller. Program and erase operations
	  execute from SRAM while interrupts are locked.
```

## drivers/flash/Kconfig.tlsr8258
```kconfig
# SPDX-FileCopyrightText: Copyright The Zephyr Project Contributors
# SPDX-License-Identifier: Apache-2.0

config SOC_FLASH_TELINK_TLSR8258
	bool "Telink TLSR8258 on-chip flash driver"
	default y
	depends on DT_HAS_TELINK_TLSR8258_FLASH_ENABLED
	select FLASH_HAS_DRIVER_ENABLED
	select FLASH_HAS_EXPLICIT_ERASE
	select FLASH_HAS_PAGE_LAYOUT
	help
	  Enable the flash driver for the SPI flash connected to the
	  TLSR8258 internal MSPI controller.

config FLASH_TLSR8258_BLOCK_PROTECT
	bool "Write-protect the lowest 256 KiB at boot"
	default n
	depends on SOC_FLASH_TELINK_TLSR8258
	help
	  Set the block-protect bits of the external flash status register to
	  cover the lowest 256 KiB, as the vendor SDK does at boot when
	  FLASH_PROTECT_ENABLE is set. Only the MIDs in the vendor table are
	  handled; other flashes are left unprotected. The bits persist across
	  reboots, so external programmers must clear them before erasing.
```

## drivers/gpio/Kconfig.phy6252
```kconfig
# SPDX-FileCopyrightText: Copyright The Zephyr Project Contributors
# SPDX-License-Identifier: Apache-2.0

config GPIO_PHY6252
	bool "PHY6252 GPIO driver"
	default y
	depends on DT_HAS_PHYPLUS_PHY6252_GPIO_ENABLED
	help
	  Enable the PHY6252 GPIO controller.
```
