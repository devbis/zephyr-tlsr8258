## boards/aithinker/pb_03f_kit/Kconfig.pb_03f_kit
```kconfig
# SPDX-FileCopyrightText: Copyright The Zephyr Project Contributors
# SPDX-License-Identifier: Apache-2.0

config BOARD_PB_03F_KIT
	select SOC_PHY62X2
```

## boards/aithinker/pb_03f_kit/board.yml
```yaml
board:
  name: pb_03f_kit
  full_name: Ai-Thinker PB-03F-Kit
  vendor: aithinker
  socs:
    - name: phy62x2
```

## boards/others/gtw360_shield/Kconfig.gtw360_shield
```kconfig
# SPDX-FileCopyrightText: Copyright The Zephyr Project Contributors
# SPDX-License-Identifier: Apache-2.0

config BOARD_GTW360_SHIELD
	select SOC_NRF52840_QIAA
```

## boards/others/gtw360_shield/board.yml
```yaml
board:
  name: gtw360_shield
  full_name: GTW360 gateway nRF52840 module
  vendor: others
  socs:
  - name: nrf52840
```

## boards/wch/ch579m_evt/Kconfig.ch579m_evt
```kconfig
# Copyright The Zephyr Project Contributors
# SPDX-License-Identifier: Apache-2.0

config BOARD_CH579M_EVT
	select SOC_CH579
```

## boards/wch/ch579m_evt/board.yml
```yaml
board:
  name: ch579m_evt
  full_name: WCH CH579M EVT
  vendor: wch
  socs:
    - name: ch579
```

## drivers/adc/Kconfig.phy62x2
```kconfig
# SPDX-FileCopyrightText: Copyright The Zephyr Project Contributors
# SPDX-License-Identifier: Apache-2.0

config ADC_PHY62X2
	bool "PHY62x2 ADC driver"
	default y
	depends on DT_HAS_PHYPLUS_PHY62X2_ADC_ENABLED
	help
	  Enable the ADC of the PHY62x2: six single-ended and four differential inputs of 12 bits,
	  the inputs below 1 V. The driver polls for the end of a conversion.
```

## drivers/counter/Kconfig.phy62x2_rtc
```kconfig
# SPDX-FileCopyrightText: Copyright The Zephyr Project Contributors
# SPDX-License-Identifier: Apache-2.0

config COUNTER_PHY62X2_RTC
	bool "PHY62x2 RTC counter"
	default y
	depends on DT_HAS_PHYPLUS_PHY62X2_RTC_ENABLED
	help
	  Enable the counter of the always-on RTC of the PHY62x2. It counts and is read; the comparators
	  and the interrupt are not used, so there are no alarms.
```

## drivers/dma/Kconfig.phy62x2
```kconfig
# SPDX-FileCopyrightText: Copyright The Zephyr Project Contributors
# SPDX-License-Identifier: Apache-2.0

config DMA_PHY62X2
	bool "PHY62x2 DMA driver"
	default y
	depends on DT_HAS_PHYPLUS_PHY62X2_DMA_ENABLED
	help
	  Enable the DMA controller of the PHY62x2: four channels, one block per transfer, memory to
	  memory and between memory and the peripherals.
```

## drivers/flash/Kconfig.phy62x2
```kconfig
# SPDX-FileCopyrightText: Copyright The Zephyr Project Contributors
# SPDX-License-Identifier: Apache-2.0

config FLASH_PHY62X2
	bool "PHY62x2 flash controller"
	default y
	depends on DT_HAS_PHYPLUS_PHY62X2_FLASH_CONTROLLER_ENABLED
	select FLASH_HAS_DRIVER_ENABLED
	select FLASH_HAS_PAGE_LAYOUT
	select FLASH_HAS_EXPLICIT_ERASE
	help
	  Enable the PHY62x2 flash controller. Program and erase operations
	  execute from SRAM while interrupts are locked.
```

## drivers/gpio/Kconfig.wch_ch57x
```kconfig
# Copyright The Zephyr Project Contributors
# SPDX-License-Identifier: Apache-2.0

config GPIO_WCH_CH57X
	bool "WCH CH57x GPIO driver"
	default y
	depends on DT_HAS_WCH_CH57X_GPIO_ENABLED
	help
	  Enable the GPIO driver for the WCH CH57x (CH579) family. Pin
	  interrupts are not supported yet.
```

## drivers/hwinfo/Kconfig.phy62x2
```kconfig
# SPDX-FileCopyrightText: Copyright The Zephyr Project Contributors
# SPDX-License-Identifier: Apache-2.0

config HWINFO_PHY62X2
	bool "PHY62x2 hwinfo driver"
	default y
	depends on SOC_PHY62X2
	select HWINFO_HAS_DRIVER
	help
	  Enable the reset cause of the PHY62x2, from the register that the boot ROM and the power off
	  of the SDK write.
```

## drivers/ieee802154/Kconfig.phy62x2
```kconfig
# SPDX-FileCopyrightText: Copyright The Zephyr Project Contributors
# SPDX-License-Identifier: Apache-2.0

menuconfig IEEE802154_PHY62X2
	bool "Phyplus PHY62x2 IEEE 802.15.4 radio"
	default y
	depends on DT_HAS_PHYPLUS_PHY62X2_RADIO_ENABLED
	help
	  Enable the experimental IEEE 802.15.4 radio driver for Phyplus PHY62x2.
	  The RF register setup is based on an unverified PHY62x2/PHY62x2 backend.

if IEEE802154_PHY62X2

config IEEE802154_PHY62X2_INIT_PRIO
	int "PHY62x2 IEEE 802.15.4 initialization priority"
	default 80

endif # IEEE802154_PHY62X2
```

## drivers/pinctrl/Kconfig.phy62x2
```kconfig
# SPDX-FileCopyrightText: Copyright The Zephyr Project Contributors
# SPDX-License-Identifier: Apache-2.0

config PINCTRL_PHY62X2
	bool "PHY62x2 pin controller"
	default y
	depends on DT_HAS_PHYPLUS_PHY62X2_PINCTRL_ENABLED
	help
	  Enable the pin controller of the PHY62x2: the function of a pad through the full mux of
	  the IOMUX, and its pull.
```

## drivers/pinctrl/Kconfig.wch_ch57x
```kconfig
# Copyright The Zephyr Project Contributors
# SPDX-License-Identifier: Apache-2.0

config PINCTRL_WCH_CH57X
	bool "WCH CH57x pin controller driver"
	default y
	depends on DT_HAS_WCH_CH57X_PINCTRL_ENABLED
	help
	  Enable the pin controller driver for the WCH CH57x (CH579) family.
```

## drivers/pwm/Kconfig.phy62x2
```kconfig
# SPDX-FileCopyrightText: Copyright The Zephyr Project Contributors
# SPDX-License-Identifier: Apache-2.0

config PWM_PHY62X2
	bool "PHY62x2 PWM driver"
	default y
	depends on DT_HAS_PHYPLUS_PHY62X2_PWM_ENABLED
	help
	  Enable the PWM controller of the PHY62x2, six channels with an up counter.
```

## drivers/sensor/phyplus/Kconfig
```kconfig
# Copyright The Zephyr Project Contributors
# SPDX-License-Identifier: Apache-2.0

# zephyr-keep-sorted-start
source "drivers/sensor/phyplus/phy62x2_qdec/Kconfig"
# zephyr-keep-sorted-stop
```

## drivers/sensor/phyplus/phy62x2_qdec/Kconfig
```kconfig
# Copyright The Zephyr Project Contributors
# SPDX-License-Identifier: Apache-2.0

config PHY62X2_QDEC
	bool "PHY62x2 quadrature decoder"
	default y
	depends on DT_HAS_PHYPLUS_PHY62X2_QDEC_ENABLED
	select PINCTRL
	help
	  Enable the driver for the quadrature decoder of the PHY62x2. The driver polls the counter
	  of one channel and reports the rotation in degrees.
```

## drivers/serial/Kconfig.wch_ch57x
```kconfig
# Copyright The Zephyr Project Contributors
# SPDX-License-Identifier: Apache-2.0

config UART_WCH_CH57X
	bool "WCH CH57x UART driver"
	default y
	depends on DT_HAS_WCH_CH57X_UART_ENABLED
	select SERIAL_HAS_DRIVER
	select SERIAL_SUPPORT_INTERRUPT
	select PINCTRL
	help
	  Enable the UART driver for the WCH CH57x (CH579) family.
```

## dts/bindings/adc/phyplus,phy62x2-adc.yaml
```yaml
# SPDX-FileCopyrightText: Copyright The Zephyr Project Contributors
# SPDX-License-Identifier: Apache-2.0

description: |
  Phyplus PHY62x2 ADC. The channels are numbered as in the SDK: 2 to 7 are the single-ended
  inputs on the pads P11, P23, P24, P14, P15 and P20, and the differential pairs are 1 (P18 and
  P25), 3 (P23 and P11), 5 (P14 and P24) and 7 (P20 and P15).

compatible: "phyplus,phy62x2-adc"

include: adc-controller.yaml

properties:
  reg:
    required: true

  "#io-channel-cells":
    const: 1

io-channel-cells:
  - input
```

## dts/bindings/counter/phyplus,phy62x2-rtc.yaml
```yaml
# SPDX-FileCopyrightText: Copyright The Zephyr Project Contributors
# SPDX-License-Identifier: Apache-2.0

description: |
  Phyplus PHY62x2 always-on RTC, used as a free-running counter. The registers are those of the RTC in
  the AON block, from RTCCTL on.

compatible: "phyplus,phy62x2-rtc"

include: base.yaml

properties:
  reg:
    required: true

  clock-frequency:
    type: int
    default: 32768
    description: |
      Frequency of the 32 kHz clock of the RTC before the prescaler, in Hz. The RC oscillator is
      not exactly 32768 Hz.

  prescaler:
    type: int
    default: 1
    description: |
      Divider of the clock of the counter, 1 to 4096. The SDK keeps it at 1.
```

## dts/bindings/dma/phyplus,phy62x2-dma.yaml
```yaml
# SPDX-FileCopyrightText: Copyright The Zephyr Project Contributors
# SPDX-License-Identifier: Apache-2.0

description: |
  Phyplus PHY62x2 DMA controller, a DesignWare AHB one with four channels. The channel 0 moves
  blocks of up to 2047 transfers, the others up to 31.

compatible: "phyplus,phy62x2-dma"

include: dma-controller.yaml

properties:
  reg:
    required: true

  interrupts:
    required: true

  "#dma-cells":
    const: 2

dma-cells:
  - channel
  - slot
```

## dts/bindings/flash_controller/phyplus,phy62x2-flash-controller.yaml
```yaml
# SPDX-FileCopyrightText: Copyright The Zephyr Project Contributors
# SPDX-License-Identifier: Apache-2.0

description: Phyplus PHY62x2 flash controller

compatible: "phyplus,phy62x2-flash-controller"

include: base.yaml

properties:
  reg:
    required: true
```
