## CMakeLists.txt
```
# SPDX-FileCopyrightText: Copyright The Zephyr Project Contributors
# SPDX-License-Identifier: Apache-2.0

cmake_minimum_required(VERSION 3.20.0)
find_package(Zephyr REQUIRED HINTS $ENV{ZEPHYR_BASE})
project(tlsr8258_pm_timer)

target_sources(app PRIVATE src/main.c)
```

## sample.yaml
```
sample:
  name: TLSR8258 PM timer smoke
tests:
  sample.boards.telink.tlsr8258_pm_timer:
    build_only: true
    platform_allow:
      - tlsr8258_generic
    tags:
      - telink
      - pm
```

## prj.conf
```kconfig
# SPDX-FileCopyrightText: Copyright The Zephyr Project Contributors
# SPDX-License-Identifier: Apache-2.0

CONFIG_SERIAL=y
CONFIG_CONSOLE=y
CONFIG_UART_CONSOLE=y
CONFIG_PRINTK=y
CONFIG_PM=y
CONFIG_GPIO=y
CONFIG_PINCTRL=y
CONFIG_TICKLESS_KERNEL=y
```

## src/main.c
```c
/*
 * SPDX-FileCopyrightText: Copyright The Zephyr Project Contributors
 * SPDX-License-Identifier: Apache-2.0
 */

#include <stdint.h>

#include <zephyr/kernel.h>
#include <zephyr/sys/printk.h>
#include <tlsr82xx/irq.h>
#include <tlsr825x/power.h>

int main(void)
{
	enum tlsr8258_pm_wakeup_reason reason;
	int ret;

	printk("TLSR8258 suspend with timer wakeup\n");

	/*
	 * The suspend stalls the core and wakes on the 32 kHz timer without
	 * advancing the kernel clock, so keep the system timer masked across it.
	 */
	tlsr82xx_irq_mask_write(tlsr82xx_irq_mask_read() & ~BIT(TLSR82XX_IRQ_SYSTEM_TIMER));
	tlsr82xx_irq_clear_parent(TLSR82XX_IRQ_SYSTEM_TIMER);

	ret = tlsr8258_pm_suspend_for_ms(100u);
	reason = tlsr8258_pm_get_wakeup_reason();

	tlsr82xx_irq_mask_write(tlsr82xx_irq_mask_read() | BIT(TLSR82XX_IRQ_SYSTEM_TIMER));

	if (ret != 0) {
		printk("suspend failed: %d\n", ret);
		return 0;
	}

	printk("woke up, reason %s\n", (reason == TLSR8258_PM_WAKEUP_TIMER) ? "timer" : "other");

	return 0;
}
```
