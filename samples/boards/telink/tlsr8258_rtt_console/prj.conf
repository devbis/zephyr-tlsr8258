## CMakeLists.txt
```
# SPDX-License-Identifier: Apache-2.0

cmake_minimum_required(VERSION 3.20.0)

find_package(Zephyr REQUIRED HINTS $ENV{ZEPHYR_BASE})
project(tlsr8258_rtt_console)

target_sources(app PRIVATE src/main.c)
```

## sample.yaml
```
# SPDX-License-Identifier: Apache-2.0

sample:
  name: TLSR8258 RTT console smoke
tests:
  sample.boards.telink.tlsr8258_rtt_console:
    build_only: true
    platform_allow:
      - tlsr8258_generic
    integration_platforms:
      - tlsr8258_generic
    tags:
      - telink
      - tlsr8258
      - console
      - logging
      - rtt
```

## prj.conf
```kconfig
CONFIG_SERIAL=n
CONFIG_UART_CONSOLE=n

CONFIG_CONSOLE=y
CONFIG_PRINTK=y
CONFIG_TLSR8258_RTT_CONSOLE=y

CONFIG_SYS_CLOCK_EXISTS=y
CONFIG_TLSR8258_STIMER=y
CONFIG_MAIN_STACK_SIZE=1024
```

## src/main.c
```c
/*
 * SPDX-FileCopyrightText: Copyright The Zephyr Project Contributors
 * SPDX-License-Identifier: Apache-2.0
 */

#include <stdint.h>
#include <zephyr/kernel.h>

volatile uint32_t tlsr8258_rtt_marker;
volatile uint32_t tlsr8258_rtt_count;

int main(void)
{
	tlsr8258_rtt_marker = 0x8258a000u;

	printk("tlsr8258 RTT console start\n");

	for (;;) {
		tlsr8258_rtt_count++;
		tlsr8258_rtt_marker = 0x8258a000u | (tlsr8258_rtt_count & 0xffu);

		printk("printk tick\n");

		k_sleep(K_MSEC(1000));
	}
}
```
