## CMakeLists.txt
```
# SPDX-License-Identifier: Apache-2.0

cmake_minimum_required(VERSION 3.20.0)
find_package(Zephyr REQUIRED HINTS $ENV{ZEPHYR_BASE})
project(tlsr8258_irq_controller)

target_sources(app PRIVATE src/main.c)
```

## prj.conf
```kconfig
# SPDX-License-Identifier: Apache-2.0

CONFIG_MAIN_STACK_SIZE=1024
CONFIG_BOOT_BANNER=n
CONFIG_PRINTK=n
CONFIG_SYS_CLOCK_EXISTS=n
CONFIG_TIMESLICING=n
CONFIG_SYSTEM_WORKQUEUE_NO_YIELD=y
```

## src/main.c
```c
/*
 * SPDX-License-Identifier: Apache-2.0
 */

#include <stdint.h>
#include <zephyr/irq.h>
#include <zephyr/kernel.h>
#include <tlsr825x/irq.h>

volatile uint32_t tlsr_irqctl_marker;
volatile uint32_t tlsr_irqctl_bad_irq;
volatile uint32_t tlsr_irqctl_mask_snapshot;

static FUNC_NORETURN void park(uint32_t marker)
{
	tlsr_irqctl_marker = marker;
	tlsr_irqctl_mask_snapshot = tlsr8258_irq_mask_read();

	for (;;) {
		compiler_barrier();
	}
}

int main(void)
{
	uint32_t saved_mask;
	unsigned int key;

	tlsr_irqctl_marker = 0x82584000u;
	key = irq_lock();
	saved_mask = tlsr8258_irq_mask_read();
	tlsr8258_irq_mask_write(0u);

	for (unsigned int irq = 0u; irq < TLSR8258_NUM_IRQS + 2u; irq++) {
		bool valid = tlsr8258_irq_is_valid(irq);

		irq_enable(irq);
		if (irq_is_enabled(irq) != valid) {
			tlsr_irqctl_bad_irq = irq;
			tlsr8258_irq_mask_write(saved_mask);
			irq_unlock(key);
			park(0x8258e401u);
		}

		irq_disable(irq);
		if (irq_is_enabled(irq)) {
			tlsr_irqctl_bad_irq = irq;
			tlsr8258_irq_mask_write(saved_mask);
			irq_unlock(key);
			park(0x8258e402u);
		}

		if (tlsr8258_irq_is_edge(irq)) {
			tlsr8258_irq_clear_edge(irq);
		}
	}

	if ((tlsr8258_irq_mask_read() & TLSR8258_IRQ_RESERVED_MASK) != 0u) {
		tlsr8258_irq_mask_write(saved_mask);
		irq_unlock(key);
		park(0x8258e403u);
	}

	tlsr8258_irq_mask_write(saved_mask);
	irq_unlock(key);
	park(0x82580000u);
}
```
