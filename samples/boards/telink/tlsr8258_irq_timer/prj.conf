## CMakeLists.txt
```
# SPDX-FileCopyrightText: Copyright The Zephyr Project Contributors
# SPDX-License-Identifier: Apache-2.0

cmake_minimum_required(VERSION 3.20.0)
find_package(Zephyr REQUIRED HINTS $ENV{ZEPHYR_BASE})
project(tlsr8258_irq_timer)

target_sources(app PRIVATE src/main.c)
```

## sample.yaml
```
# SPDX-FileCopyrightText: Copyright The Zephyr Project Contributors
# SPDX-License-Identifier: Apache-2.0

sample:
  name: TLSR8258 system timer IRQ smoke
tests:
  sample.boards.telink.tlsr8258_irq_timer:
    build_only: true
    platform_allow:
      - tlsr8258_generic
    tags:
      - irq
      - timer
      - telink
```

## prj.conf
```kconfig
# SPDX-FileCopyrightText: Copyright The Zephyr Project Contributors
# SPDX-License-Identifier: Apache-2.0

CONFIG_MAIN_STACK_SIZE=1024
CONFIG_SYS_CLOCK_EXISTS=y
CONFIG_TLSR8258_STIMER=y
CONFIG_TLSR8258_STIMER_DEBUG_HOOK=y
```

## src/main.c
```c
/*
 * SPDX-FileCopyrightText: Copyright The Zephyr Project Contributors
 * SPDX-License-Identifier: Apache-2.0
 */

#include <zephyr/kernel.h>
#include <zephyr/irq.h>
#include <tlsr825x/irq.h>
#include <stdint.h>

volatile uint32_t tlsr_irq_count;
volatile uint32_t tlsr_irq_marker;

static void wait_ms_by_cycles(uint32_t delay_ms)
{
	uint32_t start = k_cycle_get_32();
	uint32_t wait_cycles = k_ms_to_cyc_ceil32(delay_ms);

	while ((k_cycle_get_32() - start) < wait_cycles) {
	}
}

void tlsr8258_stimer_debug_tick(void)
{
	tlsr_irq_count++;
}

int main(void)
{
	uint32_t before;
	uint32_t after_disable;

	tlsr_irq_marker = 0x82580001u;
	before = tlsr_irq_count;

	k_sleep(K_MSEC(100));
	if (tlsr_irq_count == before) {
		tlsr_irq_marker = 0x8258e001u;
		return 1;
	}

	irq_disable(TLSR8258_IRQ_SYSTEM_TIMER);
	wait_ms_by_cycles(2u);
	after_disable = tlsr_irq_count;
	wait_ms_by_cycles(50u);
	if (tlsr_irq_count != after_disable) {
		tlsr_irq_marker = 0x8258e002u;
		return 2;
	}

	irq_enable(TLSR8258_IRQ_SYSTEM_TIMER);
	before = tlsr_irq_count;
	k_sleep(K_MSEC(100));
	if (tlsr_irq_count == before) {
		tlsr_irq_marker = 0x8258e003u;
		return 3;
	}

	tlsr_irq_marker = 0x82580000u;
	return 0;
}
```
