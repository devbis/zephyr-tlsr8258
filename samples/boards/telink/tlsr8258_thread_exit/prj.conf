## CMakeLists.txt
```
# SPDX-FileCopyrightText: Copyright The Zephyr Project Contributors
# SPDX-License-Identifier: Apache-2.0

cmake_minimum_required(VERSION 3.20.0)
find_package(Zephyr REQUIRED HINTS $ENV{ZEPHYR_BASE})
project(tlsr8258_thread_exit)

target_sources(app PRIVATE src/main.c)
```

## sample.yaml
```
sample:
  name: TLSR8258 thread exit smoke
tests:
  sample.board.telink.tlsr8258_thread_exit:
    build_only: true
    platform_allow:
      - tlsr8258_generic
    integration_platforms:
      - tlsr8258_generic
    tags:
      - telink
      - tlsr8258
      - kernel
      - threads
```

## prj.conf
```kconfig
# SPDX-FileCopyrightText: Copyright The Zephyr Project Contributors
# SPDX-License-Identifier: Apache-2.0

CONFIG_MAIN_STACK_SIZE=1024
CONFIG_BOOT_BANNER=n
CONFIG_PRINTK=n
CONFIG_SYS_CLOCK_EXISTS=y
CONFIG_TLSR8258_STIMER=y
CONFIG_TIMESLICING=n
CONFIG_SYSTEM_WORKQUEUE_NO_YIELD=y
```

## src/main.c
```c
/*
 * SPDX-FileCopyrightText: Copyright The Zephyr Project Contributors
 * SPDX-License-Identifier: Apache-2.0
 */

#include <stdint.h>
#include <zephyr/kernel.h>

volatile uint32_t tlsr_thread_exit_count;
volatile uint32_t tlsr_thread_exit_marker;

K_THREAD_STACK_DEFINE(worker_stack, 1024);
static struct k_thread worker_thread;

static FUNC_NORETURN void park_with_marker(uint32_t marker)
{
	tlsr_thread_exit_marker = marker;

	for (;;) {
		compiler_barrier();
	}
}

static void worker(void *p1, void *p2, void *p3)
{
	ARG_UNUSED(p1);
	ARG_UNUSED(p2);
	ARG_UNUSED(p3);

	tlsr_thread_exit_marker = 0x82581001u;
	k_sleep(K_MSEC(20));
	tlsr_thread_exit_count++;
	tlsr_thread_exit_marker = 0x82581002u;
}

int main(void)
{
	tlsr_thread_exit_marker = 0x82581000u;

	k_thread_create(&worker_thread, worker_stack,
			K_THREAD_STACK_SIZEOF(worker_stack),
			worker, NULL, NULL, NULL,
			K_PRIO_PREEMPT(0), 0, K_NO_WAIT);

	k_sleep(K_MSEC(100));

	if (tlsr_thread_exit_count != 1u) {
		park_with_marker(0x8258e101u);
	}

	if (tlsr_thread_exit_marker != 0x82581002u) {
		park_with_marker(0x8258e102u);
	}

	park_with_marker(0x82580000u);
}
```
