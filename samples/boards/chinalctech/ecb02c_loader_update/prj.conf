## CMakeLists.txt
```
# SPDX-FileCopyrightText: Copyright The Zephyr Project Contributors
# SPDX-License-Identifier: Apache-2.0

cmake_minimum_required(VERSION 3.20.0)
find_package(Zephyr REQUIRED HINTS $ENV{ZEPHYR_BASE})
project(ecb02c_loader_update)

if(NOT DEFINED LOADER_IMAGE)
  message(FATAL_ERROR
          "Give the image of the new loader: "
          "-DLOADER_IMAGE=<MCUboot build>/zephyr/zephyr.phy6252.bin")
endif()

# The table of the sectors of the loader that hold data
set(payload ${CMAKE_CURRENT_BINARY_DIR}/loader_payload.c)
add_custom_command(
  OUTPUT ${payload}
  COMMAND ${PYTHON_EXECUTABLE} ${CMAKE_CURRENT_SOURCE_DIR}/gen_loader_payload.py
          ${LOADER_IMAGE} ${payload}
  DEPENDS ${LOADER_IMAGE} ${CMAKE_CURRENT_SOURCE_DIR}/gen_loader_payload.py
  VERBATIM
)

target_sources(app PRIVATE src/main.c src/loader_update.c ${payload})
target_include_directories(app PRIVATE src)
```

## prj.conf
```kconfig
# SPDX-FileCopyrightText: Copyright The Zephyr Project Contributors
# SPDX-License-Identifier: Apache-2.0

CONFIG_PRINTK=y
CONFIG_SERIAL=y
CONFIG_UART_INTERRUPT_DRIVEN=y
CONFIG_FLASH=y

CONFIG_SHELL=y
CONFIG_SHELL_BACKEND_SERIAL=y
CONFIG_REBOOT=y
CONFIG_MAIN_STACK_SIZE=2048
CONFIG_SYSTEM_WORKQUEUE_STACK_SIZE=2048

# MCUboot with one application slot starts the application
CONFIG_BOOTLOADER_MCUBOOT=y
CONFIG_MCUBOOT_BOOTLOADER_MODE_SINGLE_APP=y
CONFIG_MCUBOOT_GENERATE_UNSIGNED_IMAGE=y
```

## src/main.c
```c
/*
 * SPDX-FileCopyrightText: Copyright The Zephyr Project Contributors
 * SPDX-License-Identifier: Apache-2.0
 */

#include <zephyr/kernel.h>
#include <zephyr/sys/printk.h>
#include <zephyr/sys/reboot.h>

#include "loader_update.h"

int main(void)
{
	const int rc = loader_update();

	printk("ECB02C loader update: loader_update() = %d\n", rc);
	if (rc == 1) {
		printk("the new loader is in the flash, rebooting\n");
		k_msleep(200);
		sys_reboot(SYS_REBOOT_COLD);
	}

	return 0;
}
```

## src/loader_payload.h
```c
/*
 * SPDX-FileCopyrightText: Copyright The Zephyr Project Contributors
 * SPDX-License-Identifier: Apache-2.0
 */

#ifndef LOADER_PAYLOAD_H_
#define LOADER_PAYLOAD_H_

#include <stdint.h>

#define LOADER_SECTOR_SIZE 4096U

struct loader_sector {
	/* In the flash */
	uint32_t offset;
	uint8_t data[LOADER_SECTOR_SIZE];
};

extern const struct loader_sector loader_sectors[];
extern const unsigned int loader_sector_count;

#endif /* LOADER_PAYLOAD_H_ */
```

## src/loader_update.c
```c
/*
 * SPDX-FileCopyrightText: Copyright The Zephyr Project Contributors
 * SPDX-License-Identifier: Apache-2.0
 */

#include <string.h>
#include <zephyr/device.h>
#include <zephyr/drivers/flash.h>
#include <zephyr/kernel.h>
#include <zephyr/sys/printk.h>

#include "loader_payload.h"
#include "loader_update.h"

#define CHUNK 256U

static uint8_t chunk[CHUNK];

/* A chunk of a sector of the payload as it is in the flash? */
static bool chunk_same(const struct device *fl, const struct loader_sector *sector, unsigned int c)
{
	return (flash_read(fl, sector->offset + c * CHUNK, chunk, CHUNK) == 0) &&
	       (memcmp(chunk, &sector->data[c * CHUNK], CHUNK) == 0);
}

static bool sector_same(const struct device *fl, const struct loader_sector *sector)
{
	for (unsigned int c = 0U; c < LOADER_SECTOR_SIZE / CHUNK; c++) {
		if (!chunk_same(fl, sector, c)) {
			return false;
		}
	}

	return true;
}

int loader_update(void)
{
	const struct device *fl = DEVICE_DT_GET(DT_NODELABEL(flash_controller));
	unsigned int differ = 0U;

	if (!device_is_ready(fl)) {
		return -ENODEV;
	}

	for (unsigned int s = 0U; s < loader_sector_count; s++) {
		if (!sector_same(fl, &loader_sectors[s])) {
			differ++;
		}
	}
	if (differ == 0U) {
		printk("loader update: the loader is up to date (%u sectors)\n",
		       loader_sector_count);
		return 0;
	}
	printk("loader update: %u of %u sectors differ, writing\n", differ, loader_sector_count);

	for (unsigned int s = 0U; s < loader_sector_count; s++) {
		const struct loader_sector *sector = &loader_sectors[s];

		if (sector_same(fl, sector)) {
			continue;
		}
		if (flash_erase(fl, sector->offset, LOADER_SECTOR_SIZE) != 0) {
			printk("loader update: erase of 0x%x failed\n", sector->offset);
			return -EIO;
		}
		for (unsigned int c = 0U; c < LOADER_SECTOR_SIZE / CHUNK; c++) {
			if ((flash_write(fl, sector->offset + c * CHUNK, &sector->data[c * CHUNK],
					 CHUNK) != 0) ||
			    !chunk_same(fl, sector, c)) {
				printk("loader update: write of 0x%x failed\n",
				       sector->offset + c * CHUNK);
				return -EIO;
			}
		}
		printk("loader update: 0x%x done\n", sector->offset);
	}

	return 1;
}
```

## src/loader_update.h
```c
/*
 * SPDX-FileCopyrightText: Copyright The Zephyr Project Contributors
 * SPDX-License-Identifier: Apache-2.0
 */

#ifndef LOADER_UPDATE_H_
#define LOADER_UPDATE_H_

/**
 * @brief Bring the loader in the flash to the one of the payload
 *
 * @retval 1 The loader was rewritten
 * @retval 0 The loader is the same
 * @retval -ENODEV The flash is not ready
 * @retval -EIO An erase or a write failed, the loader may be incomplete
 */
int loader_update(void);

#endif /* LOADER_UPDATE_H_ */
```
