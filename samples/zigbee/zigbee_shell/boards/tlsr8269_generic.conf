## subsys/zigbee/Kconfig
```kconfig
# SPDX-FileCopyrightText: Copyright The Zephyr Project Contributors
# SPDX-License-Identifier: Apache-2.0

DT_CHOSEN_ZIGBEE_RETAINED_MEM := zigbee,retained-mem

menuconfig ZIGBEE
	bool "Zigbee protocol support"
	depends on ZIGBEE_RADIO_PORT
	depends on NET_L2_CUSTOM_IEEE802154
	depends on !IEEE802154_L2_PKT_INCL_FCS
	select NVS
	select FLASH
	select FLASH_MAP
	select HWINFO
	help
	  Enable Zigbee subsystem.
	  AES-128 is provided by the TLSR8258 hardware accelerator.
	  Other targets use the software implementation.

	  Zigbee runs its own MAC on top of the IEEE 802.15.4 radio driver and
	  receives through a custom L2, so it is only available with
	  CONFIG_NET_L2_CUSTOM_IEEE802154 enabled, an IEEE 802.15.4 radio driver
	  enabled, and CONFIG_IEEE802154_L2_PKT_INCL_FCS disabled.

if ZIGBEE

choice ZIGBEE_ROLE
	prompt "Zigbee device role"
	default ZIGBEE_ED

config ZIGBEE_ED
	bool "End Device"

config ZIGBEE_ROUTER
	bool "Router"

config ZIGBEE_COORDINATOR
	bool "Coordinator"

endchoice

config ZIGBEE_NATIVE_SIM_IEEE_LOW
	hex "native_sim fixed IEEE address low byte"
	default 0x02
	help
	  Low byte of the compiled-in IEEE address on native_sim/POSIX builds
	  (full address a4:c1:38:e0:50:02:00:XX). Build a second node with a
	  distinct value so multiple native_sim Zigbee nodes (e.g. an End Device
	  joining THROUGH a router) can share one socket medium.

config ZIGBEE_CHANNEL_MASK
	hex "Zigbee channel mask"
	default 0x07FFF800
	help
	  Channels (bit N = channel N, valid 11..26) that a router or end
	  device scans when joining, and that a coordinator chooses from when
	  forming a network. The default is all channels. A coordinator picks
	  the least busy channel of a multi-channel mask. Set a single bit
	  (for example 0x800 for channel 11) to pin the node to one channel.

config ZIGBEE_STACK_SIZE
	int "Zigbee thread stack size"
	default 2048

config ZIGBEE_THREAD_PRIO
	int "Zigbee thread priority"
	default 5

config ZIGBEE_BDB
	bool "Base Device Behavior"
	default y

config ZIGBEE_SLEEPY
	bool "Sleepy end device"
	depends on ZIGBEE_ED
	depends on ZIGBEE_BDB
	depends on PM
	depends on TICKLESS_KERNEL
	default y
	help
	  Let a joined end device sleep between parent polls. A battery powered
	  device sleeps by default; disable this for a device that must stay
	  reachable, for example while debugging. Routers and coordinators never
	  sleep: they hold every power state for the whole run.

if ZIGBEE_SLEEPY

choice ZIGBEE_SLEEPY_MODE
	prompt "Sleepy end device sleep mode"
	default ZIGBEE_SLEEPY_DEEP

config ZIGBEE_SLEEPY_DEEP
	bool "Deep sleep (the device restarts on wake)"
	depends on HAS_PM_STATE_SOFT_OFF
	depends on $(dt_chosen_enabled,$(DT_CHOSEN_ZIGBEE_RETAINED_MEM))
	select RETAINED_MEM
	help
	  Enter PM_STATE_SOFT_OFF between polls. RAM is not kept: every wake
	  boots the firmware, restores the network state from non-volatile
	  storage and polls the parent. The outgoing security frame counter
	  survives in the retained memory chosen by zigbee,retained-mem. Pick
	  this for battery powered devices.

config ZIGBEE_SLEEPY_LIGHT
	bool "Light sleep (RAM is kept, execution resumes in place)"
	help
	  Suspend between polls without a restart. Use it where a boot costs
	  more energy than the device can spare, for example a switch powered
	  through the load it controls.

endchoice

endif # ZIGBEE_SLEEPY

config ZIGBEE_ED_POLL_INTERVAL_MS
	int "Sleepy end-device parent poll interval"
	depends on ZIGBEE_ED
	range 50 60000
	default 500
	help
	  Interval between data requests to the parent in the stable joined
	  state. It is also the sleep time of one deep-sleep cycle.

config ZIGBEE_ED_FAST_POLL_INTERVAL_MS
	int "Sleepy end-device fast poll interval"
	depends on ZIGBEE_ED
	range 20 10000
	default 100
	help
	  Poll interval used while the parent is delivering data, so that a
	  request/response exchange (interview, commands) does not wait a
	  whole slow interval for every frame.

config ZIGBEE_ED_FAST_POLL_WINDOW_MS
	int "Sleepy end-device fast poll window"
	depends on ZIGBEE_ED
	range 0 60000
	default 3000
	help
	  Time the end device keeps the fast poll interval, and stays out of
	  deep sleep, after the last frame received from the parent. Zero
	  disables the fast poll window.

config ZIGBEE_ZCL
	bool "Zigbee Cluster Library"
	default y

config ZIGBEE_GP
	bool "Green Power"
	depends on ZIGBEE_ROUTER
	default n
	help
	  Green Power proxy support (vendor GP_SUPPORT_ENABLE, router-only:
	  the GP proxy relays GPDFs on behalf of GPDs, the sink role is not
	  wired in here). The GP endpoint (242) registers and interviews
	  correctly against Zigbee2MQTT, but no actual Green Power device
	  has been tested against it, so GPDF relaying itself is unverified.
	  On the tlsr8258_tb03f router build this adds ~17 KB flash and
	  ~0.6 KB RAM on top of an already tight RAM budget (~96.6% ->
	  ~97.8%).

menu "ZCL clusters"
	depends on ZIGBEE_ZCL

comment "Basic and Identify are always built; Green Power and OTA have their own options"

config ZIGBEE_ZCL_POWER_CFG
	bool "Power Configuration cluster"
	help
	  Build the Power Configuration cluster (ZCL_POWER_CFG_SUPPORT) so that an application
	  can register it.

config ZIGBEE_ZCL_DEV_TEMPERATURE_CFG
	bool "Device Temperature Configuration cluster"
	help
	  Build the Device Temperature Configuration cluster (ZCL_DEV_TEMPERATURE_CFG_SUPPORT) so that an application
	  can register it.

config ZIGBEE_ZCL_GROUP
	bool "Groups cluster"
	help
	  Build the Groups cluster (ZCL_GROUP_SUPPORT) so that an application
	  can register it.

config ZIGBEE_ZCL_SCENE
	bool "Scenes cluster"
	select ZIGBEE_ZCL_GROUP
	help
	  Build the Scenes cluster (ZCL_SCENE_SUPPORT) so that an application
	  can register it.

config ZIGBEE_ZCL_ON_OFF
	bool "On/Off cluster"
	help
	  Build the On/Off cluster (ZCL_ON_OFF_SUPPORT) so that an application
	  can register it.

config ZIGBEE_ZCL_ON_OFF_SWITCH_CFG
	bool "On/Off Switch Configuration cluster"
	help
	  Build the On/Off Switch Configuration cluster (ZCL_ON_OFF_SWITCH_CFG_SUPPORT) so that an application
	  can register it.

config ZIGBEE_ZCL_LEVEL_CTRL
	bool "Level Control cluster"
	help
	  Build the Level Control cluster (ZCL_LEVEL_CTRL_SUPPORT) so that an application
	  can register it.

config ZIGBEE_ZCL_ALARMS
	bool "Alarms cluster"
	help
	  Build the Alarms cluster (ZCL_ALARMS_SUPPORT) so that an application
	  can register it.

config ZIGBEE_ZCL_TIME
	bool "Time cluster"
	help
	  Build the Time cluster (ZCL_TIME_SUPPORT) so that an application
	  can register it.

config ZIGBEE_ZCL_RSSI_LOCATION
	bool "RSSI Location cluster"
	help
	  Build the RSSI Location cluster (ZCL_RSSI_LOCATION_SUPPORT) so that an application
	  can register it.

config ZIGBEE_ZCL_DIAGNOSTICS
	bool "Diagnostics cluster"
	help
	  Build the Diagnostics cluster (ZCL_DIAGNOSTICS_SUPPORT) so that an application
	  can register it.

config ZIGBEE_ZCL_REPORTING_TABLE_SIZE
	int "Attribute reporting table entries"
	default 4
	range 1 16
	depends on ZIGBEE_ZCL
	help
	  Number of attribute reports a peer can configure on this device. Each entry
	  costs RAM and a share of the reporting NV item; changing the size discards
	  the saved reporting configuration.

config ZIGBEE_ZCL_POLL_CTRL
	bool "Poll Control cluster"
	help
	  Build the Poll Control cluster (ZCL_POLL_CTRL_SUPPORT) so that an application
	  can register it.

config ZIGBEE_ZCL_BINARY_INPUT
	bool "Binary Input cluster"
	help
	  Build the Binary Input cluster (ZCL_BINARY_INPUT_SUPPORT) so that an application
	  can register it.

config ZIGBEE_ZCL_BINARY_OUTPUT
	bool "Binary Output cluster"
	help
	  Build the Binary Output cluster (ZCL_BINARY_OUTPUT_SUPPORT) so that an application
	  can register it.

config ZIGBEE_ZCL_MULTISTATE_INPUT
	bool "Multistate Input cluster"
	help
	  Build the Multistate Input cluster (ZCL_MULTISTATE_INPUT_SUPPORT) so that an application
	  can register it.

config ZIGBEE_ZCL_MULTISTATE_OUTPUT
	bool "Multistate Output cluster"
	help
	  Build the Multistate Output cluster (ZCL_MULTISTATE_OUTPUT_SUPPORT) so that an application
	  can register it.

config ZIGBEE_ZCL_ILLUMINANCE_MEASUREMENT
	bool "Illuminance Measurement cluster"
	help
	  Build the Illuminance Measurement cluster (ZCL_ILLUMINANCE_MEASUREMENT_SUPPORT) so that an application
	  can register it.

config ZIGBEE_ZCL_ILLUMINANCE_LEVEL_SENSING
	bool "Illuminance Level Sensing cluster"
	help
	  Build the Illuminance Level Sensing cluster (ZCL_ILLUMINANCE_LEVEL_SENSING_SUPPORT) so that an application
	  can register it.

config ZIGBEE_ZCL_TEMPERATURE_MEASUREMENT
	bool "Temperature Measurement cluster"
	help
	  Build the Temperature Measurement cluster (ZCL_TEMPERATURE_MEASUREMENT_SUPPORT) so that an application
	  can register it.

config ZIGBEE_ZCL_RELATIVE_HUMIDITY
	bool "Relative Humidity Measurement cluster"
	help
	  Build the Relative Humidity Measurement cluster (ZCL_RELATIVE_HUMIDITY_SUPPORT) so that an application
	  can register it.

config ZIGBEE_ZCL_OCCUPANCY_SENSING
	bool "Occupancy Sensing cluster"
	help
	  Build the Occupancy Sensing cluster (ZCL_OCCUPANCY_SENSING_SUPPORT) so that an application
	  can register it.

config ZIGBEE_ZCL_ELECTRICAL_MEASUREMENT
	bool "Electrical Measurement cluster"
	help
	  Build the Electrical Measurement cluster (ZCL_ELECTRICAL_MEASUREMENT_SUPPORT) so that an application
	  can register it.

config ZIGBEE_ZCL_LIGHT_COLOR_CONTROL
	bool "Color Control cluster"
	help
	  Build the Color Control cluster (ZCL_LIGHT_COLOR_CONTROL_SUPPORT) so that an application
	  can register it.

config ZIGBEE_ZCL_THERMOSTAT
	bool "Thermostat cluster"
	help
	  Build the Thermostat cluster (ZCL_THERMOSTAT_SUPPORT) so that an application
	  can register it.

config ZIGBEE_ZCL_FAN_CONTROL
	bool "Fan Control cluster"
	help
	  Build the Fan Control cluster (ZCL_FAN_CONTROL_SUPPORT) so that an application
	  can register it. It has attributes only, the application provides the table.

config ZIGBEE_ZCL_THERMOSTAT_UI_CFG
	bool "Thermostat User Interface Configuration cluster"
	help
	  Build the Thermostat User Interface Configuration cluster
	  (ZCL_THERMOSTAT_UI_CFG_SUPPORT) so that an application can register it. It
	  has attributes only, the application provides the table.

config ZIGBEE_ZCL_DOOR_LOCK
	bool "Door Lock cluster"
	help
	  Build the Door Lock cluster (ZCL_DOOR_LOCK_SUPPORT) so that an application
	  can register it.

config ZIGBEE_ZCL_WINDOW_COVERING
	bool "Window Covering cluster"
	help
	  Build the Window Covering cluster (ZCL_WINDOW_COVERING_SUPPORT) so that an application
	  can register it.

config ZIGBEE_ZCL_IAS_ZONE
	bool "IAS Zone cluster"
	help
	  Build the IAS Zone cluster (ZCL_IAS_ZONE_SUPPORT) so that an application
	  can register it.

config ZIGBEE_ZCL_IAS_ACE
	bool "IAS ACE cluster"
	help
	  Build the IAS ACE cluster (ZCL_IAS_ACE_SUPPORT) so that an application
	  can register it.

config ZIGBEE_ZCL_IAS_WD
	bool "IAS Warning Device cluster"
	help
	  Build the IAS Warning Device cluster (ZCL_IAS_WD_SUPPORT) so that an application
	  can register it.

config ZIGBEE_ZCL_METERING
	bool "Metering cluster"
	help
	  Build the Metering cluster (ZCL_METERING_SUPPORT) so that an application
	  can register it.

config ZIGBEE_ZCL_ZLL_COMMISSIONING
	bool "ZLL Commissioning (Touchlink) cluster"
	help
	  Build the ZLL Commissioning (Touchlink) cluster (ZCL_ZLL_COMMISSIONING_SUPPORT) so that an application
	  can register it.

config ZIGBEE_ZCL_WWAH
	bool "Works With All Hubs cluster"
	help
	  Build the Works With All Hubs cluster (ZCL_WWAH_SUPPORT) so that an application
	  can register it.

endmenu

config ZIGBEE_GP_SINK
	bool "Green Power sink (combo)"
	depends on ZIGBEE_GP
	select ZIGBEE_ZCL_ON_OFF
	select ZIGBEE_ZCL_LEVEL_CTRL
	help
	  Build the Green Power sink and translation table (vendor
	  GP_BASIC_COMBO) next to the proxy, so the node can pair with
	  Green Power devices and act on their commands itself. Needs
	  extra flash and RAM on top of CONFIG_ZIGBEE_GP.

config ZIGBEE_NCP
	bool "Serial network co-processor interface"
	depends on ZIGBEE_COORDINATOR
	default y
	select SERIAL
	help
	  Let a host drive the coordinator over a UART, the way it would a
	  dedicated coordinator adapter. The protocol is chosen below. A
	  coordinator is driven by a host unless this is turned off.

if ZIGBEE_NCP

choice ZIGBEE_NCP_PROTOCOL
	prompt "NCP protocol"
	default ZIGBEE_NCP_ZSTACK

config ZIGBEE_NCP_TELINK
	bool "Telink ZBHCI"
	help
	  Expose a narrow subset of Telink's vendor ZBHCI UART protocol
	  (network start, permit-join, child-node list, AF data send, ZDO
	  active-EP/simple-desc query), so a host tool can drive the
	  coordinator the same way it would a real Telink coordinator's
	  serial port. Framing and command-ID layout are adapted from
	  tl_zigbee_sdk's zbhci/ module (Apache-2.0, Telink Semiconductor);
	  only the commands listed above are implemented.

config ZIGBEE_NCP_ZSTACK
	bool "TI Z-Stack ZNP"
	help
	  Emulate the serial interface of a Z-Stack 3.0.x ZNP coordinator,
	  limited to the commands Zigbee2MQTT (adapter: zstack) and ZHA
	  (zigpy-znp) use to start the network, manage devices and exchange
	  APS data. Other commands are answered with an error.

endchoice

endif # ZIGBEE_NCP

config ZIGBEE_ZBHCI_UART
	def_bool ZIGBEE_NCP_TELINK

config ZIGBEE_ZSTACK_NCP
	def_bool ZIGBEE_NCP_ZSTACK

config ZIGBEE_OTA
	bool "OTA firmware update"
	depends on BOOTLOADER_MCUBOOT
	depends on FLASH_MAP
	select IMG_MANAGER
	select STREAM_FLASH
	help
	  Zigbee OTA Upgrade client. The server sends a standard Zigbee OTA
	  file whose image element is an MCUboot image signed with imgtool.
	  The client writes the element to slot 1 (the "slot1_partition"
	  devicetree node, see the tlsr8258-mcuboot snippet), and the
	  application calls ota_mcuReboot() on OTA_EVT_COMPLETE to have MCUboot
	  verify and test the image. The new image is confirmed once the device
	  is on the network; MCUboot reverts it on the next reset otherwise.

config ZIGBEE_OTA_CONFIRM_DELAY_S
	int "Delay before a new image is confirmed"
	default 30
	range 1 3600
	depends on ZIGBEE_OTA
	help
	  Time in seconds after boot before a test image that is joined to a
	  network marks itself as confirmed.

config ZIGBEE_MANUFACTURER_CODE
	hex "Manufacturer code"
	default 0x1141 if ZIGBEE_RADIO_PORT_TLSR8258 || ZIGBEE_RADIO_PORT_TLSR8269
	default 0x1002 if SOC_FAMILY_SILABS_S1 || SOC_FAMILY_SILABS_S2
	default 0x131B if SOC_FAMILY_ESPRESSIF_ESP32
	default 0x1279 if SOC_FAMILY_NORDIC_NRF
	default 0x1055 if SOC_FAMILY_BFLB
	default 0x123C if SOC_FAMILY_PHYPLUS
	default 0x0000
	range 0x0000 0xFFFF
	help
	  Manufacturer code of the node descriptor, which a coordinator reads, and
	  the value the OTA files of the product carry. The default is the code of
	  the SoC vendor: 0x1141 Telink, 0x1002 Silicon Labs (EFR32), 0x131B
	  Espressif, 0x1279 Nordic, 0x1055 Bouffalo Lab, 0x123C PHYPLUS (PHY62xx).
	  A product that ships under its own code sets it here. Zero, the default
	  on other SoCs, is not a registered code: the build warns until a code is
	  set.

config ZIGBEE_WWAH
	bool "Works With All Hubs"
	depends on ZIGBEE_ZCL
	select ZIGBEE_ZCL_WWAH
	default n
	help
	  Build the WWAH cluster server (wwah/). The application calls
	  wwah_init() after registering its endpoint. The attributes the
	  hub sets are stored in NV and applied again after a reset.

config ZIGBEE_MAC_TIMER_CYCLES_PER_US
	int "Zigbee MAC timer cycles per microsecond"
	default 24 if ZIGBEE_RADIO_PORT_TLSR8258
	default 24 if ZIGBEE_RADIO_PORT_TLSR8269
	default 16
	range 1 1000
	help
	  Compatibility scale for vendor MAC code that measures deadlines in
	  clock_time() cycles. The TLSR8258 Zigbee MAC path is hardware-verified
	  with the vendor 24-cycle timing scale even though Zephyr's system timer
	  runs at 16 MHz.

module = ZIGBEE
module-str = zigbee
source "subsys/logging/Kconfig.template.log_config"

endif # ZIGBEE

config ZIGBEE_RADIO_PORT
	bool

config ZIGBEE_RADIO_PORT_TLSR8258
	bool
	depends on IEEE802154_TELINK_TLSR8258
	select ZIGBEE_RADIO_PORT
	select CRYPTO
	default y if IEEE802154_TELINK_TLSR8258

config ZIGBEE_RADIO_PORT_TLSR8269
	bool
	depends on IEEE802154_TELINK_TLSR8269
	select ZIGBEE_RADIO_PORT
	select CRYPTO
	default y if IEEE802154_TELINK_TLSR8269

config ZIGBEE_AES_ENGINE
	bool
	depends on ZIGBEE
	default y if DT_HAS_ESPRESSIF_ESP32_AES_ENABLED || \
		     (DT_HAS_NORDIC_NRF_ECB_ENABLED && !HAS_BT_CTLR)
	select CRYPTO
	help
	  The SoC has an AES engine that the crypto API drives for the Zigbee
	  security service. The engine driver itself is enabled by default once
	  CRYPTO is.

config ZIGBEE_AES_SOFTWARE
	bool
	default y if !(CRYPTO_TLSR8258 || CRYPTO_ESP32_AES)
	help
	  Build the software AES-128 cipher. It is the whole implementation
	  when no engine is available, and the decrypt direction on the nRF
	  ECB peripheral, which only encrypts.

config ZIGBEE_RADIO_PORT_GENERIC
	bool
	depends on NET_L2_CUSTOM_IEEE802154 && !IEEE802154_TELINK_TLSR8258 && !IEEE802154_TELINK_TLSR8269
	select ZIGBEE_RADIO_PORT
	default y
```
