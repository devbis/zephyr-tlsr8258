## soc/arm/phy6252/Kconfig.soc
```kconfig
# SPDX-FileCopyrightText: Copyright The Zephyr Project Contributors
# SPDX-License-Identifier: Apache-2.0

config SOC_SERIES_PHY6252
	bool
	select SOC_FAMILY_ARM

config SOC_PHY6252
	bool
	select SOC_SERIES_PHY6252

config SOC_SERIES
	default "phy6252" if SOC_SERIES_PHY6252

config SOC
	default "phy6252" if SOC_PHY6252
```

## soc/phyplus/Kconfig
```kconfig
# SPDX-FileCopyrightText: Copyright The Zephyr Project Contributors
# SPDX-License-Identifier: Apache-2.0

if SOC_FAMILY_PHYPLUS

rsource "*/Kconfig"

endif # SOC_FAMILY_PHYPLUS
```

## soc/phyplus/Kconfig.soc
```kconfig
# SPDX-FileCopyrightText: Copyright The Zephyr Project Contributors
# SPDX-License-Identifier: Apache-2.0

config SOC_FAMILY_PHYPLUS
	bool

config SOC_FAMILY
	default "phyplus" if SOC_FAMILY_PHYPLUS

rsource "*/Kconfig.soc"
```

## soc/phyplus/phy6252/Kconfig
```kconfig
# SPDX-FileCopyrightText: Copyright The Zephyr Project Contributors
# SPDX-License-Identifier: Apache-2.0

config SOC_PHY6252
	select ARM
	select CPU_CORTEX_M0
	select CPU_CORTEX_M_HAS_SYSTICK
	select SOC_PREP_HOOK
	select XIP

config PHY6252_WATCHDOG
	bool "Reset the chip when the system hangs"
	default y
	depends on SOC_PHY6252 && WATCHDOG && DT_HAS_SNPS_DESIGNWARE_WATCHDOG_ENABLED
	help
	  Start the watchdog at boot and feed it from a thread of the lowest priority. A thread of a
	  higher priority that does not leave the CPU, or interrupts that stay locked, stop the
	  feeding and the chip is reset. Disable it where the code feeds the watchdog itself
	  (MCUboot).

config PHY6252_WATCHDOG_TIMEOUT_MS
	int "Timeout of the watchdog in ms"
	default 8000
	depends on PHY6252_WATCHDOG
	help
	  The timeout comes from the 32 kHz RC oscillator in steps of a power of two, 2 s up to
	  256 s.
```

## soc/phyplus/phy6252/Kconfig.defconfig
```kconfig
# SPDX-FileCopyrightText: Copyright The Zephyr Project Contributors
# SPDX-License-Identifier: Apache-2.0

if SOC_PHY6252

config NUM_IRQS
	default 32

endif
```

## soc/telink/tlsr/tlsr825x/Kconfig
```kconfig
# SPDX-FileCopyrightText: Copyright The Zephyr Project Contributors
# SPDX-License-Identifier: Apache-2.0

config SOC_SERIES_TLSR825X
	bool
	select TC32
	select HAS_PM
	select HAS_PM_STATE_SOFT_OFF
	select HAS_SEGGER_RTT if ZEPHYR_SEGGER_MODULE
	# __ramfunc is placed in .ram_code, see toolchain/gcc.h
	select ARCH_HAS_RAMFUNC_SUPPORT
	select SOC_EARLY_INIT_HOOK
	select SOC_PREP_HOOK
	select XIP

if SOC_SERIES_TLSR825X

config SOC_TLSR8258
	bool

config TLSR825X_DMA_IRQ
	bool
	help
	  Dispatcher of the DMA interrupt line, which has one vector but is
	  used by the UART and the 802.15.4 radio. Selected by the drivers
	  that register a handler with tlsr825x_dma_irq_register().

config TLSR825X_RC_CALIBRATION
	bool "Trim the RC oscillators at boot"
	default y if ZIGBEE
	help
	  Calibrate the 24 MHz RC oscillator and switch the 32 kHz clock to the
	  trimmed internal RC oscillator when the application starts, as the
	  vendor clock_init() and PM_CLOCK_INIT() do. The radio timing and the
	  32 kHz sleep timer depend on it.

config SOC_SERIES_TLSR825X_PM
	bool "TLSR825x system power management"
	default y
	depends on PM
	help
	  Suspend the SoC from the idle loop when the PM policy selects
	  PM_STATE_SUSPEND_TO_IDLE, and provide the suspend and deep-sleep
	  helpers declared in power.h.

config TLSR8258_PM_TIMER_WAKEUP
	bool "32 kHz timer wakeup"
	default y
	depends on SOC_SERIES_TLSR825X_PM
	help
	  Arm the 32 kHz timer as a wakeup source for suspend and deep sleep.

config TLSR8258_PM_GPIO_WAKEUP
	bool "GPIO wakeup"
	default y
	depends on SOC_SERIES_TLSR825X_PM
	help
	  Arm the GPIO pins configured with
	  tlsr8258_pm_configure_gpio_wakeup() as wakeup sources.

config TLSR8258_PM_DEEP_RETENTION
	bool "Deep sleep with SRAM retention"
	depends on SOC_SERIES_TLSR825X_PM
	help
	  Enter deep sleep with the low 8, 16 or 32 KiB of SRAM kept powered
	  instead of none. The wake is still a reset, so the firmware starts from
	  the reset vector and initializes .data and .bss, but what is marked
	  __tlsr8258_retained (power.h) keeps its value, and a sleepy device can
	  count time and remember what it last reported across the sleep. The
	  retained SRAM draws about a microamp more than none.

	  The sleep entry is the vendor's LOW32K sequence as reproduced in
	  tlsr8258-hal, which woke on silicon. What is not verified here is the
	  boot after the wake: it relies on the boot mirror surviving the sleep.

config TLSR8258_PM_RETENTION_SIZE
	int "Retained application RAM in bytes"
	depends on TLSR8258_PM_DEEP_RETENTION
	default 512
	range 0 24576
	help
	  Size of the .tlsr8258_retained section at the start of the RAM behind the
	  boot mirror. The boot mirror and this section must fit in 32 KiB.
	  With the default 8 KiB mirror, 8 KiB (8192) or less keeps the cost at
	  the 16 KiB retention mode.

endif # SOC_SERIES_TLSR825X
```

## soc/telink/tlsr/tlsr825x/Kconfig.defconfig
```kconfig
# SPDX-License-Identifier: Apache-2.0

if SOC_SERIES_TLSR825X

config NUM_IRQS
	default 32

config SYS_CLOCK_EXISTS
	default y

config SYS_CLOCK_HW_CYCLES_PER_SEC
	default 16000000

config XIP
	default y

config FLASH_BASE_ADDRESS
	default 0x0

config FLASH_SIZE
	default 512

config SRAM_BASE_ADDRESS
	default 0x840000

config SRAM_SIZE
	default 64

config MAIN_STACK_SIZE
	default 2048

config IDLE_STACK_SIZE
	default 1024

config TEST_EXTRA_STACK_SIZE
	default 1024

endif # SOC_SERIES_TLSR825X
```

## soc/telink/tlsr/tlsr826x/Kconfig
```kconfig
# SPDX-FileCopyrightText: Copyright The Zephyr Project Contributors
# SPDX-License-Identifier: Apache-2.0

if SOC_SERIES_TLSR826X

config SOC_TLSR8269
	bool

endif # SOC_SERIES_TLSR826X
```

## soc/telink/tlsr/tlsr826x/Kconfig.defconfig
```kconfig
# SPDX-FileCopyrightText: Copyright The Zephyr Project Contributors
# SPDX-License-Identifier: Apache-2.0

if SOC_SERIES_TLSR826X

config NUM_IRQS
	default 24

config SYS_CLOCK_EXISTS
	default y

config SYS_CLOCK_HW_CYCLES_PER_SEC
	default "$(dt_node_int_prop_int,/clocks/clock-sys,clock-frequency)"

# See soc/telink/tlsr/tlsr825x/Kconfig.defconfig for the 64-bit timeout trade-off.
config TIMEOUT_64BIT
	default n

config HAS_FLASH_LOAD_OFFSET
	default y if BOOTLOADER_MCUBOOT

config FLASH_BASE_ADDRESS
	default 0x0

config FLASH_SIZE
	default 512

config SRAM_BASE_ADDRESS
	default 0x808000

config SRAM_SIZE
	default 32

config MAIN_STACK_SIZE
	default 2048

config IDLE_STACK_SIZE
	default 1024

config TEST_EXTRA_STACK_SIZE
	default 1024

endif # SOC_SERIES_TLSR826X
```

## soc/telink/tlsr/tlsr826x/Kconfig.soc
```kconfig
# SPDX-FileCopyrightText: Copyright The Zephyr Project Contributors
# SPDX-License-Identifier: Apache-2.0

config SOC_SERIES_TLSR826X
	bool
	select SOC_FAMILY_TELINK_TLSR
	select TC32
	select HAS_PM
	select HAS_SEGGER_RTT if ZEPHYR_SEGGER_MODULE
	select ARCH_HAS_RAMFUNC_SUPPORT
	select SOC_EARLY_INIT_HOOK
	select SOC_PREP_HOOK
	select XIP
	help
	  Telink TLSR826x

config SOC_TLSR8269
	bool
	select SOC_SERIES_TLSR826X
	help
	  Telink TLSR8269

config SOC_SERIES
	default "tlsr826x" if SOC_SERIES_TLSR826X

config SOC
	default "tlsr8269" if SOC_TLSR8269
```
