/*
 * SPDX-FileCopyrightText: Copyright The Zephyr Project Contributors
 * SPDX-License-Identifier: Apache-2.0
 */

/* The ST-LINK virtual COM port (USART1) carries the NCP protocol of coordinator_znp.conf. */
/ {
	chosen {
		zigbee,ncp-uart = &usart1;
	};
};
