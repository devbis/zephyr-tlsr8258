/*
 * SPDX-FileCopyrightText: Copyright The Zephyr Project Contributors
 * SPDX-License-Identifier: Apache-2.0
 */

/* UART0 carries the NCP protocol of coordinator_znp.conf. */
/ {
	chosen {
		zigbee,ncp-uart = &uart0;
	};
};
