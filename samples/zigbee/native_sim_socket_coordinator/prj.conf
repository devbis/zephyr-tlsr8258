## CMakeLists.txt
```
# SPDX-License-Identifier: Apache-2.0
cmake_minimum_required(VERSION 3.20)
find_package(Zephyr REQUIRED HINTS $ENV{ZEPHYR_BASE})
project(native_sim_socket_coordinator)

target_sources(app PRIVATE
	src/main.c
	src/app_bdb.c
	src/app_profile.c
	src/app_interview.c
)

target_include_directories(app PRIVATE
	${ZEPHYR_BASE}/subsys/zigbee
	${ZEPHYR_BASE}/subsys/zigbee/include
    ${ZEPHYR_BASE}/subsys/zigbee/common/includes
	${ZEPHYR_BASE}/subsys/zigbee/platform/zephyr
)
```

## prj.conf
```kconfig
CONFIG_NETWORKING=y
CONFIG_NET_L2_ETHERNET=n
CONFIG_NET_L2_CUSTOM_IEEE802154=y
CONFIG_NET_TC_RX_COUNT=0
CONFIG_NET_IPV4=n
CONFIG_NET_IPV6=n
CONFIG_NET_UDP=n
CONFIG_NET_TCP=n
CONFIG_NET_SOCKETS=n
CONFIG_ETH_DRIVER=n
CONFIG_ETH_NATIVE_TAP=n

CONFIG_ZIGBEE=y
CONFIG_ZIGBEE_COORDINATOR=y
CONFIG_ZIGBEE_ZBHCI_UART=y
CONFIG_ZIGBEE_NATIVE_SIM_IEEE_LOW=0x01
CONFIG_ZIGBEE_CHANNEL=11
CONFIG_ZIGBEE_BDB=y
CONFIG_ZIGBEE_ZCL=y
CONFIG_ZIGBEE_GP=n
CONFIG_ZIGBEE_OTA=n
CONFIG_ZIGBEE_WWAH=n
# k_sys_fatal_error_handler() reboots instead of spinning forever on a
# fault/assert -- required so SYSTEM_RESET() (zb_main.c) links.
CONFIG_REBOOT=y

CONFIG_IEEE802154=y
CONFIG_IEEE802154_L2_PKT_INCL_FCS=n
CONFIG_IEEE802154_NATIVE_SIM_SOCKET=y
CONFIG_IEEE802154_NATIVE_SIM_SOCKET_BEHAVIORAL_PHY=y
CONFIG_IEEE802154_NATIVE_SIM_SOCKET_RX_FIFO_SIZE=8
CONFIG_IEEE802154_NATIVE_SIM_SOCKET_RX_WORKER_DELAY_US=1000
CONFIG_IEEE802154_NATIVE_SIM_SOCKET_RX_TURNAROUND_US=192

# CONFIG_ZIGBEE_ZBHCI_UART selects CONFIG_SERIAL/CONFIG_UART_INTERRUPT_DRIVEN
# for uart1 (the ZBHCI transport). uart0 stays the plain native_sim console
# (printk/debug logs), not the shell/log-backend UART.
CONFIG_CONSOLE=y
CONFIG_PRINTK=y
CONFIG_UART_CONSOLE=n
CONFIG_LOG=n

CONFIG_NVS=y
CONFIG_FLASH=y
CONFIG_FLASH_MAP=y

CONFIG_ZIGBEE_STACK_SIZE=4096
CONFIG_MAIN_STACK_SIZE=2048
CONFIG_SYSTEM_WORKQUEUE_STACK_SIZE=2048
CONFIG_NET_BUF_RX_COUNT=4
CONFIG_NET_BUF_TX_COUNT=4
CONFIG_OUTPUT_STAT=n
CONFIG_OUTPUT_DISASSEMBLY=n
```

## boards/native_sim_native_64.overlay
```dts
/ {
	chosen {
		zephyr,ieee802154 = &zigbee_radio;
	};

	zigbee_radio: zigbee_radio {
		compatible = "zephyr,native-sim-socket-ieee802154";
		status = "okay";
		local-mac-address = [01 00 02 50 e0 38 c1 a4];
		server-host = "127.0.0.1";
		server-port = <19011>;
		node-id = <0x0001>;
	};
};

/*
 * uart1 carries the ZBHCI protocol. uart0 stays the console/debug-log UART
 * (disabled in prj.conf on this sample, same as the other native_sim_socket_*
 * samples, but left free here in case CONFIG_SERIAL debug needs it).
 */
&uart1 {
	status = "okay";
};
```

## src/main.c
```c
/* SPDX-License-Identifier: Apache-2.0 */

#include <zephyr/device.h>
#include <zephyr/kernel.h>
#include <zephyr/logging/log.h>
#include <zephyr/zigbee/zb_bootstrap.h>
#include <zephyr/zigbee/zb_zbhci.h>

#include "app_bdb.h"

LOG_MODULE_REGISTER(main);

bool zb_platform_app_get_fixed_join_target(struct zb_platform_bdb_fixed_target *target)
{
	/*
	 * The coordinator forms its own network (bdb_networkFormationStart(),
	 * gated on CONFIG_ZIGBEE_COORDINATOR in app_bdb.c) rather than joining
	 * one, so it has no fixed join target to report.
	 */
	ARG_UNUSED(target);
	return false;
}

bool zb_platform_app_get_join_profile(struct zb_platform_bdb_join_profile *profile)
{
	return app_bdb_get_join_profile(profile);
}

void zb_platform_app_bootstrap_ready(void)
{
	app_bdb_bootstrap_ready();
}

bool zb_platform_app_enable_radio_smoke_probe(void)
{
	return false;
}

bool zb_platform_app_should_start_commissioning(void)
{
	return app_bdb_should_start_commissioning();
}

void zb_platform_app_start_commissioning(void)
{
	app_bdb_start_commissioning();
}

void zb_platform_app_network_left(void)
{
	app_bdb_network_left();
}

void zb_platform_app_bdb_commissioning_status(uint8_t status, bool joined_network)
{
	app_bdb_commissioning_status(status, joined_network);
}

int main(void)
{
	const struct device *zbhci_uart = DEVICE_DT_GET(DT_NODELABEL(uart1));
	int rc = zb_zbhci_uart_init(zbhci_uart);

	if (rc != 0) {
		LOG_ERR("zbhci uart init failed (%d)", rc);
	}

	LOG_INF("native_sim socket Zigbee coordinator ready");
	return 0;
}
```

## src/app_interview.c
```c
/*
 * Copyright The Zephyr Project Contributors
 * SPDX-License-Identifier: Apache-2.0
 */

/*
 * Interview every device that announces itself, in the order Zigbee2MQTT
 * uses: Node Descriptor, Active Endpoints, Simple Descriptor of each
 * endpoint, then the Basic cluster model identifier.
 */

#include <string.h>

#include <zephyr/logging/log.h>
#include <zephyr/zigbee/zb_bootstrap.h>

#include "platform/zephyr/compiler_zephyr.h"
#include <zephyr/zigbee/zb_types.h>
#include "zb_common.h"
#include "zbapi/zb_api.h"
#include "zdo/zdp.h"
#include "zcl/zcl_include.h"

#include "app_interview.h"
#include "app_profile.h"

LOG_MODULE_REGISTER(app_interview);

#define APP_INTERVIEW_SLOTS     4U
#define APP_INTERVIEW_MODEL_MAX 32U

struct app_interview {
	bool used;
	uint16_t nwk_addr;
	uint8_t ieee_addr[8];
};

static struct app_interview interviews[APP_INTERVIEW_SLOTS];

static struct app_interview *app_interview_find(uint16_t nwk_addr)
{
	for (size_t i = 0; i < ARRAY_SIZE(interviews); i++) {
		if (interviews[i].used && (interviews[i].nwk_addr == nwk_addr)) {
			return &interviews[i];
		}
	}

	return NULL;
}

static void app_interview_fail(uint16_t nwk_addr, const char *step, u8 status)
{
	struct app_interview *interview = app_interview_find(nwk_addr);

	LOG_ERR("interview 0x%04x: %s failed (%u)", nwk_addr, step, status);
	if (interview != NULL) {
		interview->used = false;
	}
}

static void app_interview_read_model_id(uint16_t nwk_addr, uint8_t ep)
{
	epInfo_t ep_info;
	struct {
		u8 numAttr;
		u16 attrID[1];
	} read_cmd = { 1U, { ZCL_ATTRID_BASIC_MODEL_ID } };

	memset(&ep_info, 0, sizeof(ep_info));
	ep_info.dstAddr.shortAddr = nwk_addr;
	ep_info.dstAddrMode = APS_SHORT_DSTADDR_WITHEP;
	ep_info.dstEp = ep;
	ep_info.profileId = APP_PROFILE_HA_PROFILE_ID;
	ep_info.txOptions = APS_TX_OPT_ACK_TX;
	ep_info.radius = 0U;

	if (zcl_read(APP_PROFILE_ENDPOINT, &ep_info, ZCL_CLUSTER_GEN_BASIC,
		     MANUFACTURER_CODE_NONE, 0U, ZCL_FRAME_CLIENT_SERVER_DIR, ZCL_SEQ_NUM,
		     (zclReadCmd_t *)&read_cmd) != ZCL_STA_SUCCESS) {
		app_interview_fail(nwk_addr, "model identifier read", 0U);
	}
}

static void app_interview_simple_desc_rsp(void *arg)
{
	const zdo_zdpDataInd_t *ind = arg;
	const zdo_simple_descriptor_resp_t *rsp = (const zdo_simple_descriptor_resp_t *)ind->zpdu;

	if (ind->status != ZDO_SUCCESS) {
		app_interview_fail(ind->src_addr, "simple descriptor", ind->status);
		return;
	}

	LOG_INF("interview 0x%04x: simple descriptor ep %u profile 0x%04x", ind->src_addr,
		rsp->simple_descriptor.endpoint, rsp->simple_descriptor.app_profile_id);
	app_interview_read_model_id(ind->src_addr, rsp->simple_descriptor.endpoint);
}

static void app_interview_active_ep_rsp(void *arg)
{
	const zdo_zdpDataInd_t *ind = arg;
	const zdo_active_ep_resp_t *rsp = (const zdo_active_ep_resp_t *)ind->zpdu;
	zdo_simple_descriptor_req_t req;
	u8 seq = 0U;

	if ((ind->status != ZDO_SUCCESS) || (rsp->active_ep_count == 0U)) {
		app_interview_fail(ind->src_addr, "active endpoints", ind->status);
		return;
	}

	LOG_INF("interview 0x%04x: %u active endpoint(s), first %u", ind->src_addr,
		rsp->active_ep_count, rsp->active_ep_lst[0]);
	req.nwk_addr_interest = ind->src_addr;
	req.endpoint = rsp->active_ep_lst[0];
	(void)zb_zdoSimpleDescReq(ind->src_addr, &req, &seq, app_interview_simple_desc_rsp);
}

static void app_interview_node_desc_rsp(void *arg)
{
	const zdo_zdpDataInd_t *ind = arg;
	zdo_active_ep_req_t req;
	u8 seq = 0U;

	if (ind->status != ZDO_SUCCESS) {
		app_interview_fail(ind->src_addr, "node descriptor", ind->status);
		return;
	}

	LOG_INF("interview 0x%04x: node descriptor", ind->src_addr);
	req.nwk_addr_interest = ind->src_addr;
	(void)zb_zdoActiveEpReq(ind->src_addr, &req, &seq, app_interview_active_ep_rsp);
}

void zb_platform_app_device_announce(uint16_t nwk_addr, const uint8_t ieee_addr[8])
{
	struct app_interview *interview = NULL;
	zdo_node_descriptor_req_t req;
	u8 seq = 0U;

	/* A device that announces again, possibly with a new network address,
	 * restarts its interview in the slot it already has.
	 */
	for (size_t i = 0; i < ARRAY_SIZE(interviews); i++) {
		if (interviews[i].used &&
		    (memcmp(interviews[i].ieee_addr, ieee_addr, sizeof(interviews[i].ieee_addr)) == 0)) {
			interview = &interviews[i];
			break;
		}
	}
	for (size_t i = 0; (interview == NULL) && (i < ARRAY_SIZE(interviews)); i++) {
		if (!interviews[i].used) {
			interview = &interviews[i];
		}
	}
	if (interview == NULL) {
		LOG_WRN("interview 0x%04x: no free slot", nwk_addr);
		return;
	}

	interview->used = true;
	interview->nwk_addr = nwk_addr;
	memcpy(interview->ieee_addr, ieee_addr, sizeof(interview->ieee_addr));

	LOG_INF("interview 0x%04x: started", nwk_addr);
	req.nwk_addr_interest = nwk_addr;
	(void)zb_zdoNodeDescReq(nwk_addr, &req, &seq, app_interview_node_desc_rsp);
}

void app_interview_zcl_msg(zclIncoming_t *msg)
{
	const zclReadRspCmd_t *rsp = msg->attrCmd;
	uint16_t nwk_addr = msg->msg->indInfo.src_short_addr;
	struct app_interview *interview;
	char model_id[APP_INTERVIEW_MODEL_MAX + 1];
	const u8 *data;
	u8 len;

	if ((msg->hdr.cmd != ZCL_CMD_READ_RSP) ||
	    (msg->msg->indInfo.cluster_id != ZCL_CLUSTER_GEN_BASIC)) {
		return;
	}

	interview = app_interview_find(nwk_addr);
	if (interview == NULL) {
		return;
	}

	for (u8 i = 0U; i < rsp->numAttr; i++) {
		if ((rsp->attrList[i].attrID != ZCL_ATTRID_BASIC_MODEL_ID) ||
		    (rsp->attrList[i].status != ZCL_STA_SUCCESS) ||
		    (rsp->attrList[i].dataType != ZCL_DATA_TYPE_CHAR_STR)) {
			continue;
		}

		data = rsp->attrList[i].data;
		len = MIN(data[0], APP_INTERVIEW_MODEL_MAX);
		memcpy(model_id, &data[1], len);
		model_id[len] = '\0';

		LOG_INF("interview complete nwk=0x%04x ieee=%02x%02x%02x%02x%02x%02x%02x%02x "
			"model-id=%s",
			nwk_addr, interview->ieee_addr[7], interview->ieee_addr[6],
			interview->ieee_addr[5], interview->ieee_addr[4], interview->ieee_addr[3],
			interview->ieee_addr[2], interview->ieee_addr[1], interview->ieee_addr[0],
			model_id);
		interview->used = false;
		return;
	}
}
```

## src/app_profile.c
```c
/* SPDX-License-Identifier: Apache-2.0 */

#include "app_profile.h"

#if defined(__ZEPHYR__)
#include <zephyr/logging/log.h>
LOG_MODULE_REGISTER(app_profile);

#include "platform/zephyr/compiler_zephyr.h"
#include <zephyr/zigbee/zb_types.h>
#include "af/zb_af.h"
#include "zcl/zcl_const.h"
#include "zcl/zcl.h"
#include "zcl/general/zcl_basic.h"
#include "zcl/general/zcl_identify.h"
void zcl_rx_handler(void *p);
#include "app_interview.h"
#endif

static const u8 app_basic_zcl_ver = 3U;
static const u8 app_basic_app_ver = 1U;
static const u8 app_basic_stack_ver = 2U;
static const u8 app_basic_hw_ver = 1U;
static const u8 app_basic_power_src = 0x03U;
static const u16 app_basic_cluster_rev = ZCL_ATTR_GLOBAL_CLUSTER_REVISION_DEFAULT;

static const u8 app_basic_mfr_name[] = {
	sizeof(APP_PROFILE_MFR_NAME) - 1U,
	'T', 'e', 'l', 'i', 'n', 'k',
};

static const u8 app_basic_model_id[] = {
	sizeof(APP_PROFILE_MODEL_ID) - 1U,
	'n', 'a', 't', 'i', 'v', 'e', '-', 's', 'i', 'm', '-',
	'c', 'o', 'o', 'r', 'd', 'i', 'n', 'a', 't', 'o', 'r',
};

static const zclAttrInfo_t app_basic_attr_tbl[] = {
	{ ZCL_ATTRID_BASIC_ZCL_VER, ZCL_DATA_TYPE_UINT8, ACCESS_CONTROL_READ,
	  (u8 *)&app_basic_zcl_ver },
	{ ZCL_ATTRID_BASIC_APP_VER, ZCL_DATA_TYPE_UINT8, ACCESS_CONTROL_READ,
	  (u8 *)&app_basic_app_ver },
	{ ZCL_ATTRID_BASIC_STACK_VER, ZCL_DATA_TYPE_UINT8, ACCESS_CONTROL_READ,
	  (u8 *)&app_basic_stack_ver },
	{ ZCL_ATTRID_BASIC_HW_VER, ZCL_DATA_TYPE_UINT8, ACCESS_CONTROL_READ,
	  (u8 *)&app_basic_hw_ver },
	{ ZCL_ATTRID_BASIC_MFR_NAME, ZCL_DATA_TYPE_CHAR_STR, ACCESS_CONTROL_READ,
	  (u8 *)app_basic_mfr_name },
	{ ZCL_ATTRID_BASIC_MODEL_ID, ZCL_DATA_TYPE_CHAR_STR, ACCESS_CONTROL_READ,
	  (u8 *)app_basic_model_id },
	{ ZCL_ATTRID_BASIC_POWER_SOURCE, ZCL_DATA_TYPE_ENUM8, ACCESS_CONTROL_READ,
	  (u8 *)&app_basic_power_src },
	{ ZCL_ATTRID_GLOBAL_CLUSTER_REVISION, ZCL_DATA_TYPE_UINT16, ACCESS_CONTROL_READ,
	  (u8 *)&app_basic_cluster_rev },
};

#define APP_BASIC_ATTR_NUM ((u8)(sizeof(app_basic_attr_tbl) / sizeof(app_basic_attr_tbl[0])))

static u16 app_identify_time;
static const u16 app_identify_cluster_rev = ZCL_ATTR_GLOBAL_CLUSTER_REVISION_DEFAULT;

static const zclAttrInfo_t app_identify_attr_tbl[] = {
	{ ZCL_ATTRID_IDENTIFY_TIME, ZCL_DATA_TYPE_UINT16, ACCESS_CONTROL_READ,
	  (u8 *)&app_identify_time },
	{ ZCL_ATTRID_GLOBAL_CLUSTER_REVISION, ZCL_DATA_TYPE_UINT16, ACCESS_CONTROL_READ,
	  (u8 *)&app_identify_cluster_rev },
};

#define APP_IDENTIFY_ATTR_NUM \
	((u8)(sizeof(app_identify_attr_tbl) / sizeof(app_identify_attr_tbl[0])))

static u16 app_in_clusters[] = {
	ZCL_CLUSTER_GEN_BASIC,
	ZCL_CLUSTER_GEN_IDENTIFY,
};

static af_simple_descriptor_t app_simple_desc = {
	.app_profile_id = APP_PROFILE_HA_PROFILE_ID,
	.app_dev_id = APP_PROFILE_HA_DEVICE_ID,
	.endpoint = APP_PROFILE_ENDPOINT,
	.app_dev_ver = 1U,
	.reserved = 0U,
	.app_in_cluster_count = 2U,
	.app_out_cluster_count = 0U,
	.app_in_cluster_lst = app_in_clusters,
	.app_out_cluster_lst = NULL,
};

static zcl_specClusterInfo_t app_cluster_info[] = {
	{
		.clusterId = ZCL_CLUSTER_GEN_BASIC,
		.manuCode = 0U,
		.attrNum = APP_BASIC_ATTR_NUM,
		.attrTbl = app_basic_attr_tbl,
		.clusterRegisterFunc = zcl_basic_register,
		.clusterAppCb = NULL,
	},
	{
		.clusterId = ZCL_CLUSTER_GEN_IDENTIFY,
		.manuCode = 0U,
		.attrNum = APP_IDENTIFY_ATTR_NUM,
		.attrTbl = app_identify_attr_tbl,
		.clusterRegisterFunc = zcl_identify_register,
		.clusterAppCb = NULL,
	},
};

#define APP_CLUSTER_NUM ((u8)(sizeof(app_cluster_info) / sizeof(app_cluster_info[0])))

void app_profile_register(void)
{
	zcl_init(app_interview_zcl_msg);

	if (af_simpleDescGet(APP_PROFILE_ENDPOINT) == NULL) {
		if (!af_endpointRegister(APP_PROFILE_ENDPOINT, &app_simple_desc,
					 (af_endpoint_cb_t)zcl_rx_handler, NULL)) {
			LOG_WRN("app_profile: endpoint %u register failed", APP_PROFILE_ENDPOINT);
		}
	}

	zcl_register(APP_PROFILE_ENDPOINT, APP_CLUSTER_NUM, app_cluster_info);
}

void zb_platform_app_register_endpoints(void)
{
	app_profile_register();
}

const char *zb_platform_app_basic_mfr_name(void)
{
	return APP_PROFILE_MFR_NAME;
}

const char *zb_platform_app_basic_model_id(void)
{
	return APP_PROFILE_MODEL_ID;
}

const void *app_profile_get_simple_desc(void)
{
	return &app_simple_desc;
}

const char *app_profile_mfr_name(void)
{
	return APP_PROFILE_MFR_NAME;
}

const char *app_profile_model_id(void)
{
	return APP_PROFILE_MODEL_ID;
}
```

## src/app_profile.h
```c
/* SPDX-License-Identifier: Apache-2.0 */

#pragma once

#define APP_PROFILE_HA_PROFILE_ID 0x0104U
#define APP_PROFILE_HA_DEVICE_ID  0x0000U
#define APP_PROFILE_ENDPOINT      0x01U

#define APP_PROFILE_MFR_NAME      "Telink"
#define APP_PROFILE_MODEL_ID      "native-sim-coordinator"

void app_profile_register(void);
const void *app_profile_get_simple_desc(void);
const char *app_profile_mfr_name(void);
const char *app_profile_model_id(void);
```
