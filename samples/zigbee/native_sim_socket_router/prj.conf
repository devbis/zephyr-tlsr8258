## CMakeLists.txt
```
# SPDX-License-Identifier: Apache-2.0
cmake_minimum_required(VERSION 3.20)
find_package(Zephyr REQUIRED HINTS $ENV{ZEPHYR_BASE})
project(native_sim_socket_router)

target_sources(app PRIVATE
	src/main.c
	src/app_bdb.c
	src/app_profile.c
)

target_include_directories(app PRIVATE
	${ZEPHYR_BASE}/subsys/zigbee
	${ZEPHYR_BASE}/subsys/zigbee/include
    ${ZEPHYR_BASE}/subsys/zigbee/common/includes
	${ZEPHYR_BASE}/subsys/zigbee/platform/zephyr
)
```

## prj.conf
```kconfig
CONFIG_NETWORKING=y
CONFIG_NET_L2_ETHERNET=n
CONFIG_NET_L2_CUSTOM_IEEE802154=y
CONFIG_NET_TC_RX_COUNT=0
CONFIG_NET_IPV4=n
CONFIG_NET_IPV6=n
CONFIG_NET_UDP=n
CONFIG_NET_TCP=n
CONFIG_NET_SOCKETS=n
CONFIG_ETH_DRIVER=n
CONFIG_ETH_NATIVE_TAP=n

CONFIG_ZIGBEE=y
CONFIG_ZIGBEE_ROUTER=y
CONFIG_ZIGBEE_NATIVE_SIM_IEEE_LOW=0x03
CONFIG_ZIGBEE_CHANNEL=11
CONFIG_ZIGBEE_BDB=y
CONFIG_ZIGBEE_ZCL=y
CONFIG_ZIGBEE_GP=n
CONFIG_ZIGBEE_OTA=n
CONFIG_ZIGBEE_WWAH=n
# k_sys_fatal_error_handler() reboots instead of spinning forever on a
# fault/assert -- required so SYSTEM_RESET() (zb_main.c) links.
CONFIG_REBOOT=y

CONFIG_IEEE802154=y
CONFIG_IEEE802154_L2_PKT_INCL_FCS=n
CONFIG_IEEE802154_NATIVE_SIM_SOCKET=y
CONFIG_IEEE802154_NATIVE_SIM_SOCKET_BEHAVIORAL_PHY=y
CONFIG_IEEE802154_NATIVE_SIM_SOCKET_RX_FIFO_SIZE=8
CONFIG_IEEE802154_NATIVE_SIM_SOCKET_RX_WORKER_DELAY_US=1000
CONFIG_IEEE802154_NATIVE_SIM_SOCKET_RX_TURNAROUND_US=192

CONFIG_CONSOLE=y
CONFIG_PRINTK=y
CONFIG_SERIAL=n
CONFIG_UART_CONSOLE=n
CONFIG_LOG=n

CONFIG_NVS=y
CONFIG_FLASH=y
CONFIG_FLASH_MAP=y

CONFIG_ZIGBEE_STACK_SIZE=4096
CONFIG_MAIN_STACK_SIZE=2048
CONFIG_SYSTEM_WORKQUEUE_STACK_SIZE=2048
CONFIG_NET_BUF_RX_COUNT=4
CONFIG_NET_BUF_TX_COUNT=4
CONFIG_OUTPUT_STAT=n
CONFIG_OUTPUT_DISASSEMBLY=n
```

## boards/native_sim_native_64.overlay
```dts
/ {
	chosen {
		zephyr,ieee802154 = &zigbee_radio;
	};

	zigbee_radio: zigbee_radio {
		compatible = "zephyr,native-sim-socket-ieee802154";
		status = "okay";
		local-mac-address = [03 00 02 50 e0 38 c1 a4];
		server-host = "127.0.0.1";
		server-port = <19011>;
		node-id = <0x2203>;
	};
};
```

## src/main.c
```c
/* SPDX-License-Identifier: Apache-2.0 */

#include <zephyr/kernel.h>
#include <zephyr/logging/log.h>
#include <zephyr/zigbee/zb_bootstrap.h>

#include "app_bdb.h"

LOG_MODULE_REGISTER(main);

bool zb_platform_app_get_fixed_join_target(struct zb_platform_bdb_fixed_target *target)
{
	/*
	 * Let normal BDB network-steer learn the PAN/parent from the active-scan
	 * Beacon (the coordinator on this medium), instead of constraining this
	 * router to a fixed target.
	 */
	ARG_UNUSED(target);
	return false;
}

bool zb_platform_app_get_join_profile(struct zb_platform_bdb_join_profile *profile)
{
	return app_bdb_get_join_profile(profile);
}

void zb_platform_app_bootstrap_ready(void)
{
	app_bdb_bootstrap_ready();
}

bool zb_platform_app_enable_radio_smoke_probe(void)
{
	return false;
}

bool zb_platform_app_should_start_commissioning(void)
{
	return app_bdb_should_start_commissioning();
}

void zb_platform_app_start_commissioning(void)
{
	app_bdb_start_commissioning();
}

void zb_platform_app_network_left(void)
{
	app_bdb_network_left();
}

void zb_platform_app_bdb_commissioning_status(uint8_t status, bool joined_network)
{
	app_bdb_commissioning_status(status, joined_network);
}

int main(void)
{
	LOG_INF("native_sim socket Zigbee router ready");
	return 0;
}
```

## src/app_bdb.c
```c
/* SPDX-License-Identifier: Apache-2.0 */

#include "../../zigbee_shell/src/app_bdb.c"
```

## src/app_profile.c
```c
/* SPDX-License-Identifier: Apache-2.0 */

#include "app_profile.h"

#if defined(__ZEPHYR__)
#include <zephyr/logging/log.h>
LOG_MODULE_REGISTER(app_profile);

#include "platform/zephyr/compiler_zephyr.h"
#include <zephyr/zigbee/zb_types.h>
#include "af/zb_af.h"
#include "zcl/zcl_const.h"
#include "zcl/zcl.h"
#include "zcl/general/zcl_basic.h"
#include "zcl/general/zcl_identify.h"
void zcl_rx_handler(void *p);
#endif

static const u8 app_basic_zcl_ver = 3U;
static const u8 app_basic_app_ver = 1U;
static const u8 app_basic_stack_ver = 2U;
static const u8 app_basic_hw_ver = 1U;
static const u8 app_basic_power_src = 0x01U;
static const u16 app_basic_cluster_rev = ZCL_ATTR_GLOBAL_CLUSTER_REVISION_DEFAULT;

static const u8 app_basic_mfr_name[] = {
	sizeof(APP_PROFILE_MFR_NAME) - 1U,
	'T', 'e', 'l', 'i', 'n', 'k',
};

static const u8 app_basic_model_id[] = {
	sizeof(APP_PROFILE_MODEL_ID) - 1U,
	'n', 'a', 't', 'i', 'v', 'e', '-', 's', 'i', 'm', '-',
	'r', 'o', 'u', 't', 'e', 'r',
};

static const zclAttrInfo_t app_basic_attr_tbl[] = {
	{ ZCL_ATTRID_BASIC_ZCL_VER, ZCL_DATA_TYPE_UINT8, ACCESS_CONTROL_READ,
	  (u8 *)&app_basic_zcl_ver },
	{ ZCL_ATTRID_BASIC_APP_VER, ZCL_DATA_TYPE_UINT8, ACCESS_CONTROL_READ,
	  (u8 *)&app_basic_app_ver },
	{ ZCL_ATTRID_BASIC_STACK_VER, ZCL_DATA_TYPE_UINT8, ACCESS_CONTROL_READ,
	  (u8 *)&app_basic_stack_ver },
	{ ZCL_ATTRID_BASIC_HW_VER, ZCL_DATA_TYPE_UINT8, ACCESS_CONTROL_READ,
	  (u8 *)&app_basic_hw_ver },
	{ ZCL_ATTRID_BASIC_MFR_NAME, ZCL_DATA_TYPE_CHAR_STR, ACCESS_CONTROL_READ,
	  (u8 *)app_basic_mfr_name },
	{ ZCL_ATTRID_BASIC_MODEL_ID, ZCL_DATA_TYPE_CHAR_STR, ACCESS_CONTROL_READ,
	  (u8 *)app_basic_model_id },
	{ ZCL_ATTRID_BASIC_POWER_SOURCE, ZCL_DATA_TYPE_ENUM8, ACCESS_CONTROL_READ,
	  (u8 *)&app_basic_power_src },
	{ ZCL_ATTRID_GLOBAL_CLUSTER_REVISION, ZCL_DATA_TYPE_UINT16, ACCESS_CONTROL_READ,
	  (u8 *)&app_basic_cluster_rev },
};

#define APP_BASIC_ATTR_NUM ((u8)(sizeof(app_basic_attr_tbl) / sizeof(app_basic_attr_tbl[0])))

static u16 app_identify_time;
static const u16 app_identify_cluster_rev = ZCL_ATTR_GLOBAL_CLUSTER_REVISION_DEFAULT;

static const zclAttrInfo_t app_identify_attr_tbl[] = {
	{ ZCL_ATTRID_IDENTIFY_TIME, ZCL_DATA_TYPE_UINT16, ACCESS_CONTROL_READ,
	  (u8 *)&app_identify_time },
	{ ZCL_ATTRID_GLOBAL_CLUSTER_REVISION, ZCL_DATA_TYPE_UINT16, ACCESS_CONTROL_READ,
	  (u8 *)&app_identify_cluster_rev },
};

#define APP_IDENTIFY_ATTR_NUM \
	((u8)(sizeof(app_identify_attr_tbl) / sizeof(app_identify_attr_tbl[0])))

static u16 app_in_clusters[] = {
	ZCL_CLUSTER_GEN_BASIC,
	ZCL_CLUSTER_GEN_IDENTIFY,
};

static af_simple_descriptor_t app_simple_desc = {
	.app_profile_id = APP_PROFILE_HA_PROFILE_ID,
	.app_dev_id = APP_PROFILE_HA_DEVICE_ID,
	.endpoint = APP_PROFILE_ENDPOINT,
	.app_dev_ver = 1U,
	.reserved = 0U,
	.app_in_cluster_count = 2U,
	.app_out_cluster_count = 0U,
	.app_in_cluster_lst = app_in_clusters,
	.app_out_cluster_lst = NULL,
};

static zcl_specClusterInfo_t app_cluster_info[] = {
	{
		.clusterId = ZCL_CLUSTER_GEN_BASIC,
		.manuCode = 0U,
		.attrNum = APP_BASIC_ATTR_NUM,
		.attrTbl = app_basic_attr_tbl,
		.clusterRegisterFunc = zcl_basic_register,
		.clusterAppCb = NULL,
	},
	{
		.clusterId = ZCL_CLUSTER_GEN_IDENTIFY,
		.manuCode = 0U,
		.attrNum = APP_IDENTIFY_ATTR_NUM,
		.attrTbl = app_identify_attr_tbl,
		.clusterRegisterFunc = zcl_identify_register,
		.clusterAppCb = NULL,
	},
};

#define APP_CLUSTER_NUM ((u8)(sizeof(app_cluster_info) / sizeof(app_cluster_info[0])))

void app_profile_register(void)
{
	zcl_init(NULL);

	if (af_simpleDescGet(APP_PROFILE_ENDPOINT) == NULL) {
		if (!af_endpointRegister(APP_PROFILE_ENDPOINT, &app_simple_desc,
					 (af_endpoint_cb_t)zcl_rx_handler, NULL)) {
			LOG_WRN("app_profile: endpoint %u register failed", APP_PROFILE_ENDPOINT);
		}
	}

	zcl_register(APP_PROFILE_ENDPOINT, APP_CLUSTER_NUM, app_cluster_info);
}

void zb_platform_app_register_endpoints(void)
{
	app_profile_register();
}

const char *zb_platform_app_basic_mfr_name(void)
{
	return APP_PROFILE_MFR_NAME;
}

const char *zb_platform_app_basic_model_id(void)
{
	return APP_PROFILE_MODEL_ID;
}

const void *app_profile_get_simple_desc(void)
{
	return &app_simple_desc;
}

const char *app_profile_mfr_name(void)
{
	return APP_PROFILE_MFR_NAME;
}

const char *app_profile_model_id(void)
{
	return APP_PROFILE_MODEL_ID;
}
```

## src/app_profile.h
```c
/* SPDX-License-Identifier: Apache-2.0 */

#pragma once

#define APP_PROFILE_HA_PROFILE_ID 0x0104U
#define APP_PROFILE_HA_DEVICE_ID  0x0000U
#define APP_PROFILE_ENDPOINT      0x01U

#define APP_PROFILE_MFR_NAME      "Telink"
#define APP_PROFILE_MODEL_ID      "native-sim-router"

void app_profile_register(void);
const void *app_profile_get_simple_desc(void);
const char *app_profile_mfr_name(void);
const char *app_profile_model_id(void);
```
