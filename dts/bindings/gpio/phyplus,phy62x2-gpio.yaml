## dts/bindings/gpio/phyplus,phy62x2-gpio.yaml
```yaml
# SPDX-FileCopyrightText: Copyright The Zephyr Project Contributors
# SPDX-License-Identifier: Apache-2.0

description: Phyplus PHY62x2 GPIO controller

compatible: "phyplus,phy62x2-gpio"

include: [base.yaml, gpio-controller.yaml]

properties:
  reg:
    required: true
  interrupts:
    required: true
  "#gpio-cells":
    const: 2

gpio-cells:
  - pin
  - flags
```

## dts/bindings/gpio/wch,ch57x-gpio.yaml
```yaml
# Copyright The Zephyr Project Contributors
# SPDX-License-Identifier: Apache-2.0

description: WCH CH57x GPIO port (PA has 16 pins, PB has 24 pins)

compatible: "wch,ch57x-gpio"

include: [gpio-controller.yaml, base.yaml]

properties:
  reg:
    required: true

  "#gpio-cells":
    const: 2

gpio-cells:
  - pin
  - flags
```

## dts/bindings/ieee802154/phyplus,phy62x2-radio.yaml
```yaml
# SPDX-FileCopyrightText: Copyright The Zephyr Project Contributors
# SPDX-License-Identifier: Apache-2.0

description: Phyplus PHY62x2 IEEE 802.15.4 radio

compatible: "phyplus,phy62x2-radio"

include: base.yaml

properties:
  reg:
    required: true
    description: RF, link-layer, TX FIFO, and RX FIFO register windows.

  interrupts:
    required: true
    description: Baseband and link-layer radio interrupt.
```

## dts/bindings/pinctrl/phyplus,phy62x2-pinctrl.yaml
```yaml
# SPDX-FileCopyrightText: Copyright The Zephyr Project Contributors
# SPDX-License-Identifier: Apache-2.0

description: |
  Phyplus PHY62x2 pin controller. A state lists nodes with one pad each: the pad, the function
  that the full mux of the IOMUX gives it, and the pull.

compatible: "phyplus,phy62x2-pinctrl"

include: base.yaml

properties:
  reg:
    required: true

child-binding:
  description: A pad and its function

  include:
    - name: pincfg-node.yaml
      property-allowlist:
        - bias-disable
        - bias-pull-down
        - bias-pull-up

  properties:
    phyplus,strong-pull-up:
      type: boolean
      description: |
        Use the strong pull-up with bias-pull-up, the weak one is the default.

    pinmux:
      required: true
      type: int
      description: |
        The pad and the function, made with PHY62X2_PINMUX() of
        include/zephyr/dt-bindings/pinctrl/phy62x2-pinctrl.h. PHY62X2_FMUX_NONE leaves the pad a
        GPIO and sets only the pull.
```

## dts/bindings/pinctrl/wch,ch57x-pinctrl.yaml
```yaml
# Copyright The Zephyr Project Contributors
# SPDX-License-Identifier: Apache-2.0

description: |
  WCH CH57x pin controller. It configures the GPIO direction, pulls and
  output level of the listed pins and selects the pin location of the
  peripheral through R16_PIN_ALTERNATE.

  Pins are described with the CH57X_PIN() / CH57X_PIN_ALT() macros of
  <zephyr/dt-bindings/pinctrl/ch57x-pinctrl.h>. A pin that is driven by the
  peripheral (UART TX) needs output-high, a pin that is read (UART RX) needs
  bias-pull-up or no output property at all.

compatible: "wch,ch57x-pinctrl"

include: base.yaml

properties:
  reg:
    required: true

child-binding:
  description: Pin configuration state.
  child-binding:
    description: Group of pins sharing one configuration.

    include:
      - name: pincfg-node.yaml
        property-allowlist:
          - bias-pull-up
          - bias-pull-down
          - output-high
          - output-low

    properties:
      pinmux:
        required: true
        type: array
        description: Pins, as CH57X_PIN() or CH57X_PIN_ALT().
```

## dts/bindings/power/phyplus,phy62x2-poweroff-wakeup.yaml
```yaml
# SPDX-FileCopyrightText: Copyright The Zephyr Project Contributors
# SPDX-License-Identifier: Apache-2.0

description: |
  The pads that wake the PHY62x2 from sys_poweroff(). A pad that is GPIO_ACTIVE_LOW wakes the chip on
  the falling edge and gets the strong pull-up, a pad that is GPIO_ACTIVE_HIGH wakes it on the rising
  edge and gets the pull-down. The chip then starts from the boot ROM; the RAM is not retained.

compatible: "phyplus,phy62x2-poweroff-wakeup"

include: base.yaml

properties:
  gpios:
    type: phandle-array
    required: true
```

## dts/bindings/pwm/phyplus,phy62x2-pwm.yaml
```yaml
# SPDX-FileCopyrightText: Copyright The Zephyr Project Contributors
# SPDX-License-Identifier: Apache-2.0

description: |
  Phyplus PHY62x2 PWM controller. Six channels with an up counter of 16 bits. The channels
  share the prescaler. The pads are the PHY62X2_FMUX_PWM0 to PHY62X2_FMUX_PWM5 functions of the
  pinctrl state.

compatible: "phyplus,phy62x2-pwm"

include: [pwm-controller.yaml, pinctrl-device.yaml, base.yaml]

properties:
  reg:
    required: true

  "#pwm-cells":
    const: 3

  clock-frequency:
    type: int
    default: 16000000
    description: |
      Clock of the counters before the prescaler, in Hz. 16 MHz is assumed: the SDK does not give it.

  prescaler:
    type: int
    default: 0
    enum: [0, 1, 2, 3, 4, 5, 6, 7]
    description: |
      The counter clock is clock-frequency divided by 2 to the power of this value.

  pinctrl-0:
    required: true

  pinctrl-names:
    required: true

pwm-cells:
  - channel
  - period
  - flags
```

## dts/bindings/sensor/phyplus,phy62x2-qdec.yaml
```yaml
# SPDX-FileCopyrightText: Copyright The Zephyr Project Contributors
# SPDX-License-Identifier: Apache-2.0

description: |
  Phyplus PHY62x2 quadrature decoder. One of its three channels, X, Y and Z, is used. The sensor
  reports SENSOR_CHAN_ROTATION: the rotation since the last fetch, from the counter and steps.

compatible: "phyplus,phy62x2-qdec"

include: [sensor-device.yaml, pinctrl-device.yaml]

properties:
  reg:
    required: true

  pinctrl-0:
    required: true

  pinctrl-names:
    required: true

  steps:
    type: int
    required: true
    description: Number of steps on the rotating wheel

  channel:
    type: int
    default: 0
    enum: [0, 1, 2]
    description: |
      The channel of the decoder: 0 is X, 1 is Y and 2 is Z. The pads of the channel are the
      PHY62X2_FMUX_QDEC_CHAX, _CHBX (and _CHIX for the index) functions of the pinctrl state, with
      Y and Z in place of X for the other channels.

  quadrature-mode:
    type: int
    default: 4
    enum: [1, 2, 4]
    description: Number of counts per period of the signals.
```

## dts/bindings/serial/wch,ch57x-uart.yaml
```yaml
# Copyright The Zephyr Project Contributors
# SPDX-License-Identifier: Apache-2.0

description: WCH CH57x UART (16550-like, 8-byte FIFO)

compatible: "wch,ch57x-uart"

include: [uart-controller.yaml, pinctrl-device.yaml]

properties:
  reg:
    required: true

  interrupts:
    required: true

  stop-bits:
    default: "1"

  data-bits:
    default: 8
```

## soc/phyplus/phy62x2/Kconfig
```kconfig
# SPDX-FileCopyrightText: Copyright The Zephyr Project Contributors
# SPDX-License-Identifier: Apache-2.0

config SOC_PHY62X2
	select ARM
	select CPU_CORTEX_M0
	select CPU_CORTEX_M_HAS_SYSTICK
	select HAS_POWEROFF
	select SOC_PREP_HOOK
	select XIP

config PHY62X2_DEEP_SLEEP
	bool "Deep sleep with retained RAM"
	depends on SOC_PHY62X2
	help
	  Provide phy62x2_deep_sleep(): the chip sleeps until a timeout or a wake pad and starts from the
	  boot ROM, keeping the RAM of the zephyr,retained-ram nodes. It has not been tried on hardware.

config PHY62X2_SUSPEND
	bool "Suspend to RAM"
	depends on SOC_PHY62X2
	help
	  Provide phy62x2_suspend(): the chip sleeps with its RAM retained and the program continues after the
	  wakeup. The registers of the peripherals are lost in the sleep. It has not been tried on hardware.

config PHY62X2_WATCHDOG
	bool "Reset the chip when the system hangs"
	default y
	depends on SOC_PHY62X2 && WATCHDOG && DT_HAS_SNPS_DESIGNWARE_WATCHDOG_ENABLED
	help
	  Start the watchdog at boot and feed it from a thread of the lowest priority. A thread of a
	  higher priority that does not leave the CPU, or interrupts that stay locked, stop the
	  feeding and the chip is reset. Disable it where the code feeds the watchdog itself
	  (MCUboot).

config PHY62X2_WATCHDOG_TIMEOUT_MS
	int "Timeout of the watchdog in ms"
	default 8000
	depends on PHY62X2_WATCHDOG
	help
	  The timeout comes from the 32 kHz RC oscillator in steps of a power of two, 2 s up to
	  256 s.
```

## soc/phyplus/phy62x2/Kconfig.soc
```kconfig
# SPDX-FileCopyrightText: Copyright The Zephyr Project Contributors
# SPDX-License-Identifier: Apache-2.0

config SOC_SERIES_PHY62X2
	bool
	select SOC_FAMILY_PHYPLUS

config SOC_PHY62X2
	bool
	select SOC_SERIES_PHY62X2

config SOC_SERIES
	default "phy62x2" if SOC_SERIES_PHY62X2

config SOC
	default "phy62x2" if SOC_PHY62X2
```

## soc/wch/ch57x/ch579/Kconfig
```kconfig
# SPDX-License-Identifier: Apache-2.0

config SOC_CH579
	select ARM
	select CPU_CORTEX_M0
	select CPU_CORTEX_M_HAS_SYSTICK
	select SOC_EARLY_INIT_HOOK
	select BUILD_OUTPUT_HEX
```

## soc/wch/ch57x/ch579/Kconfig.defconfig
```kconfig
# SPDX-License-Identifier: Apache-2.0

if SOC_CH579

config SYS_CLOCK_HW_CYCLES_PER_SEC
	default $(dt_node_int_prop_int,/cpus/cpu@0,clock-frequency)

config NUM_IRQS
	default 20

endif # SOC_CH579
```

## soc/wch/ch57x/ch579/Kconfig.soc
```kconfig
# SPDX-License-Identifier: Apache-2.0

config SOC_CH579
	bool
	help
	  WCH CH579 (Arm Cortex-M0, 250 KiB flash, 32 KiB SRAM, BLE/Ethernet/USB).

config SOC
	default "ch579" if SOC_CH579
```
