## dts/bindings/ieee802154/phyplus,phy6252-radio.yaml
```yaml
# SPDX-FileCopyrightText: Copyright The Zephyr Project Contributors
# SPDX-License-Identifier: Apache-2.0

description: Phyplus PHY6252 IEEE 802.15.4 radio

compatible: "phyplus,phy6252-radio"

include: base.yaml

properties:
  reg:
    required: true
    description: RF, link-layer, TX FIFO, and RX FIFO register windows.

  interrupts:
    required: true
    description: Baseband and link-layer radio interrupt.
```

## dts/bindings/ieee802154/st,stm32wb-ieee802154.yaml
```yaml
# SPDX-FileCopyrightText: Copyright The Zephyr Project Contributors
# SPDX-License-Identifier: Apache-2.0

description: |
  STM32WB IEEE 802.15.4 radio. The CPU2 runs ST's OpenThread RCP firmware
  (stm32wb5x_Thread_RCP_fw.bin); the driver talks Spinel to it over the IPCC.

compatible: "st,stm32wb-ieee802154"

include: base.yaml

properties:
  clocks:
    required: true

  interrupts:
    required: true
    # Rely on interrupt-names for the consistency.

  interrupt-names:
    required: true
    enum: ["rx", "tx"]
    min-len: 2
    max-len: 2
```

## dts/bindings/ieee802154/telink,tlsr8258-zb.yaml
```yaml
# SPDX-License-Identifier: Apache-2.0

description: Telink TLSR8258 IEEE 802.15.4 RF node

compatible: "telink,tlsr8258-zb"

include: base.yaml

properties:
  reg:
    required: true

  interrupts:
    required: true
```

## dts/bindings/ieee802154/telink,tlsr8269-zb.yaml
```yaml
# SPDX-FileCopyrightText: Copyright The Zephyr Project Contributors
# SPDX-License-Identifier: Apache-2.0

description: Telink TLSR8269 IEEE 802.15.4 RF node

compatible: "telink,tlsr8269-zb"

include: base.yaml

properties:
  reg:
    required: true

  interrupts:
    required: true
```

## dts/bindings/ieee802154/zephyr,native-sim-socket-ieee802154.yaml
```yaml
# SPDX-License-Identifier: Apache-2.0

description: native_sim socket-backed IEEE 802.15.4 radio

compatible: "zephyr,native-sim-socket-ieee802154"

include: base.yaml

properties:
  local-mac-address:
    type: uint8-array
    required: true
    description: |
      EUI-64 address presented by the simulated radio to Zephyr.

  server-host:
    type: string
    default: "127.0.0.1"
    description: |
      IPv4 address of the host-side socket medium/coordinator process.

  server-port:
    type: int
    required: true
    description: |
      UDP port used by the host-side socket medium/coordinator process.

  node-id:
    type: int
    required: true
    description: |
      Stable node identifier sent over the localhost socket-medium protocol.
```

## dts/bindings/interrupt-controller/telink,tlsr8258-intc.yaml
```yaml
description: Telink TLSR8258 interrupt controller

compatible: "telink,tlsr8258-intc"

include: [interrupt-controller.yaml, base.yaml]

properties:
  reg:
    required: true

interrupt-cells:
  - irq
```

## dts/bindings/pinctrl/telink,tlsr8258-pinctrl.yaml
```yaml
# SPDX-License-Identifier: Apache-2.0

description: Telink TLSR8258 pin controller

compatible: "telink,tlsr8258-pinctrl"

include: base.yaml

child-binding:
  description: TLSR8258 pin control state

  include:
    - name: pincfg-node.yaml
      property-allowlist:
        - bias-disable
        - bias-pull-down
        - bias-pull-up
        - input-enable
        - output-enable

  properties:
    pinmux:
      required: true
      type: int
      description: TLSR8258_PINMUX(pin, function) value.
```

## dts/bindings/pinctrl/telink,tlsr8269-pinctrl.yaml
```yaml
# SPDX-FileCopyrightText: Copyright The Zephyr Project Contributors
# SPDX-License-Identifier: Apache-2.0

description: Telink TLSR8269 pin controller

compatible: "telink,tlsr8269-pinctrl"

include: base.yaml

child-binding:
  description: TLSR8269 pin control state

  include:
    - name: pincfg-node.yaml
      property-allowlist:
        - bias-disable
        - bias-pull-down
        - bias-pull-up
        - input-enable
        - output-enable

  properties:
    pinmux:
      required: true
      type: int
      description: TLSR8269_PINMUX(pin, function) value.
```

## dts/bindings/pwm/telink,tlsr8258-pwm.yaml
```yaml
# SPDX-FileCopyrightText: Copyright The Zephyr Project Contributors
# SPDX-License-Identifier: Apache-2.0

description: Telink TLSR8258 PWM controller

compatible: "telink,tlsr8258-pwm"

include: [pwm-controller.yaml, pinctrl-device.yaml, base.yaml]

properties:
  reg:
    required: true

  clocks:
    required: true
    description: |
      System clock the PWM divider works from.

  prescaler:
    type: int
    default: 0
    description: |
      Value written to PWM_CLKDIV. The PWM tick rate is
      system clock / (prescaler + 1). The divider is shared by all
      channels and cannot change at runtime. Range 0 to 255.

  "#pwm-cells":
    const: 3

pwm-cells:
  - channel
  - period
  - flags
```

## dts/bindings/retained_mem/st,stm32-bkp-retained.yaml
```yaml
# SPDX-FileCopyrightText: Copyright The Zephyr Project Contributors
# SPDX-License-Identifier: Apache-2.0

description: |
  Retained memory in the RTC backup registers of an STM32 SoC. The registers
  keep their value across a Standby wake, which resets the core and the SRAM.

compatible: "st,stm32-bkp-retained"

include: base.yaml

properties:
  first-register:
    type: int
    default: 0
    description: Index of the first backup register of the region.

  size:
    type: int
    required: true
    description: Size of the region in bytes, a multiple of 4.
```

## dts/bindings/retained_mem/telink,tlsr8258-analog-retained.yaml
```yaml
# SPDX-FileCopyrightText: Copyright The Zephyr Project Contributors
# SPDX-License-Identifier: Apache-2.0

description: |
  Retained memory in TLSR8258 analog registers. The registers keep their
  value across deep-sleep wake, which resets the core and the SRAM.

compatible: "telink,tlsr8258-analog-retained"

include: base.yaml

properties:
  analog-address:
    type: int
    required: true
    description: Analog register address of the first retained byte.

  size:
    type: int
    required: true
    description: Number of retained bytes.
```

## dts/bindings/rng/telink,tlsr8258-rng.yaml
```yaml
# SPDX-FileCopyrightText: Copyright The Zephyr Project Contributors
# SPDX-License-Identifier: Apache-2.0

description: |
  Telink TLSR8258 random number source. It samples the noise of the SAR ADC
  with both inputs of the miscellaneous channel on ground, the way the vendor
  random_generator_init() does, so it shares the ADC with the adc driver.

compatible: "telink,tlsr8258-rng"

include: base.yaml
```

## dts/bindings/serial/telink,tlsr8258-uart.yaml
```yaml
# SPDX-FileCopyrightText: Copyright The Zephyr Project Contributors
# SPDX-License-Identifier: Apache-2.0

description: Telink TLSR8258 UART

compatible: "telink,tlsr8258-uart"

include: [uart-controller.yaml, pinctrl-device.yaml]

properties:
  reg:
    required: true

  interrupts:
    required: true

  clocks:
    required: true
    description: |
      System clock the baud rate divider is derived from; its clock-frequency
      is what the driver divides.

  tx-pin:
    type: int
    required: true
    description: Vendor GPIO pin value used for UART TX.

  rx-pin:
    type: int
    description: Vendor GPIO pin value used for UART RX.
```

## dts/bindings/serial/telink,tlsr8269-uart.yaml
```yaml
# SPDX-FileCopyrightText: Copyright The Zephyr Project Contributors
# SPDX-License-Identifier: Apache-2.0

description: Telink TLSR8269 UART

compatible: "telink,tlsr8269-uart"

include: [uart-controller.yaml, pinctrl-device.yaml]

properties:
  reg:
    required: true

  clocks:
    required: true
    description: |
      System clock the baud rate divider is derived from; its clock-frequency
      is what the driver divides.
```

## dts/bindings/spi/telink,tlsr8258-spi.yaml
```yaml
# SPDX-FileCopyrightText: Copyright The Zephyr Project Contributors
# SPDX-License-Identifier: Apache-2.0

description: Telink TLSR8258 SPI master controller

compatible: "telink,tlsr8258-spi"

include: [spi-controller.yaml, pinctrl-device.yaml]

properties:
  reg:
    required: true

  clocks:
    required: true
    description: |
      System clock the SPI divider is derived from. The SPI clock is
      system clock / (2 * (div + 1)).
```

## dts/bindings/timer/telink,tlsr8258-stimer.yaml
```yaml
# SPDX-FileCopyrightText: Copyright The Zephyr Project Contributors
# SPDX-License-Identifier: Apache-2.0

description: |
  Telink TLSR8258 system timer. A free-running 32-bit counter clocked at the
  system tick rate with one compare register that raises the timer
  interrupt; used as the kernel system clock.

compatible: "telink,tlsr8258-stimer"

include: [base.yaml]

properties:
  reg:
    required: true

  interrupts:
    required: true

  clocks:
    required: true
```

## dts/bindings/watchdog/telink,tlsr8258-watchdog.yaml
```yaml
# SPDX-FileCopyrightText: Copyright The Zephyr Project Contributors
# SPDX-License-Identifier: Apache-2.0

description: Telink TLSR8258 timer2-based watchdog

compatible: "telink,tlsr8258-watchdog"

include: base.yaml

properties:
  reg:
    required: true

  clock-frequency:
    type: int
    required: true
    description: Rate of the timer2 tick that the watchdog compares against, in Hz.
```

## samples/zigbee/zigbee_shell/boards/esp32h2_devkitm_esp32h2.conf
```kconfig
# SPDX-FileCopyrightText: Copyright The Zephyr Project Contributors
# SPDX-License-Identifier: Apache-2.0

CONFIG_ZIGBEE_CHANNEL_MASK=0x800

CONFIG_COUNTER=y
CONFIG_PM_DEVICE=y
```

## samples/zigbee/zigbee_shell/boards/nrf52840dk_nrf52840.conf
```kconfig
# SPDX-FileCopyrightText: Copyright The Zephyr Project Contributors
# SPDX-License-Identifier: Apache-2.0

CONFIG_IEEE802154_NRF5=y
CONFIG_ZIGBEE_STACK_SIZE=4096
```

## samples/zigbee/zigbee_shell/boards/pb_03f.conf
```kconfig
# SPDX-FileCopyrightText: Copyright The Zephyr Project Contributors
# SPDX-License-Identifier: Apache-2.0

CONFIG_CONSOLE=y
CONFIG_UART_CONSOLE=y
CONFIG_SERIAL=y
CONFIG_PRINTK=y
CONFIG_LOG=y
CONFIG_LOG_MODE_MINIMAL=y
```
