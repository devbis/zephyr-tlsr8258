## dts/bindings/crypto/telink,tlsr8258-aes.yaml
```yaml
# SPDX-FileCopyrightText: Copyright The Zephyr Project Contributors
# SPDX-License-Identifier: Apache-2.0

description: |
  Telink TLSR8258 AES accelerator.

  A single-block AES-128 engine.  It exposes an 8-bit control register, a
  32-bit data register that is fed and drained four words at a time, and a
  16-byte key register file.  The engine performs one ECB block per run and
  signals completion through the control register; it has no interrupt and
  no DMA.

compatible: "telink,tlsr8258-aes"

include: [base.yaml]

properties:
  reg:
    required: true
```

## dts/bindings/flash_controller/phyplus,phy6252-flash-controller.yaml
```yaml
# SPDX-FileCopyrightText: Copyright The Zephyr Project Contributors
# SPDX-License-Identifier: Apache-2.0

description: Phyplus PHY6252 flash controller

compatible: "phyplus,phy6252-flash-controller"

include: base.yaml

properties:
  reg:
    required: true
```

## dts/bindings/flash_controller/telink,tlsr8258-flash.yaml
```yaml
# SPDX-License-Identifier: Apache-2.0

description: Telink TLSR8258 on-chip SPI flash

compatible: "telink,tlsr8258-flash"

include: base.yaml

properties:
  reg:
    required: true

  write-block-size:
    type: int
    required: true
```

## dts/bindings/gpio/phyplus,phy6252-gpio.yaml
```yaml
# SPDX-FileCopyrightText: Copyright The Zephyr Project Contributors
# SPDX-License-Identifier: Apache-2.0

description: Phyplus PHY6252 GPIO controller

compatible: "phyplus,phy6252-gpio"

include: [base.yaml, gpio-controller.yaml]

properties:
  reg:
    required: true
  interrupts:
    required: true
  "#gpio-cells":
    const: 2

gpio-cells:
  - pin
  - flags
```

## dts/bindings/gpio/telink,tlsr8258-gpio.yaml
```yaml
# SPDX-License-Identifier: Apache-2.0

description: Telink TLSR8258 GPIO port

compatible: "telink,tlsr8258-gpio"

include: [gpio-controller.yaml, base.yaml]

properties:
  reg:
    required: true

  "#gpio-cells":
    const: 2

gpio-cells:
  - pin
  - flags
```

## dts/bindings/i2c/telink,tlsr8258-i2c.yaml
```yaml
# SPDX-FileCopyrightText: Copyright The Zephyr Project Contributors
# SPDX-License-Identifier: Apache-2.0

description: Telink TLSR8258 I2C controller (controller mode)

compatible: "telink,tlsr8258-i2c"

include: [i2c-controller.yaml, pinctrl-device.yaml]

properties:
  reg:
    required: true

  clocks:
    required: true
    description: |
      System clock the I2C divider is derived from. Its clock-frequency
      selects the divider: I2C clock = system clock / (4 * divider).

  pinctrl-0:
    required: true
    description: |
      SDA and SCL pin states using TLSR8258_FUNC_I2C. Supported pairs are
      PA3/PA4, PB6/PD7, PC0/PC1 and PC2/PC3.
```
