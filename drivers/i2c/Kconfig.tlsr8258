## drivers/i2c/Kconfig.tlsr8258
```kconfig
# SPDX-FileCopyrightText: Copyright The Zephyr Project Contributors
# SPDX-License-Identifier: Apache-2.0

config I2C_TELINK_TLSR8258
	bool "Telink TLSR8258 I2C controller driver"
	default y
	depends on DT_HAS_TELINK_TLSR8258_I2C_ENABLED
	select PINCTRL
	help
	  Enable the polled controller-mode I2C driver for the TLSR8258 hardware
	  I2C block. Target mode uses the hardware mapping buffer and needs
	  CONFIG_I2C_TARGET; it is not verified on hardware.
```

## drivers/ieee802154/Kconfig.native_sim_socket
```kconfig
# SPDX-FileCopyrightText: Copyright The Zephyr Project Contributors
# SPDX-License-Identifier: Apache-2.0

menuconfig IEEE802154_NATIVE_SIM_SOCKET
	bool "native_sim socket IEEE 802.15.4 driver"
	depends on BOARD_NATIVE_SIM_NATIVE_64
	depends on DT_HAS_ZEPHYR_NATIVE_SIM_SOCKET_IEEE802154_ENABLED
	select NET_PKT_TIMESTAMP if !IEEE802154_RAW_MODE
	help
	  Experimental IEEE 802.15.4 driver for native_sim/native/64 that
	  exchanges PSDUs with a host-side medium process over a UDP socket.
	  A thread of the driver reads the socket every millisecond.

if IEEE802154_NATIVE_SIM_SOCKET

config IEEE802154_NATIVE_SIM_SOCKET_INIT_PRIO
	int "native_sim socket IEEE 802.15.4 initialization priority"
	default 80

config IEEE802154_NATIVE_SIM_SOCKET_RX_STACK_SIZE
	int "native_sim socket RX thread stack size"
	default 4096

config IEEE802154_NATIVE_SIM_SOCKET_RX_PRIO
	int "native_sim socket RX thread priority"
	default 4
	range 0 NUM_PREEMPT_PRIORITIES
	help
	  Preemptive priority of the thread that reads the socket and hands the
	  frames to the network stack.

config IEEE802154_NATIVE_SIM_SOCKET_BEHAVIORAL_PHY
	bool "Model a radio RX FIFO and deferred frame handoff"
	help
	  Insert a bounded, delayed RX FIFO between the socket medium and the
	  network stack. It models a radio that buffers received frames for a
	  deferred worker: FIFO depth, worker latency, RX/TX turnaround and
	  deterministic frame drops.

if IEEE802154_NATIVE_SIM_SOCKET_BEHAVIORAL_PHY

config IEEE802154_NATIVE_SIM_SOCKET_RX_FIFO_SIZE
	int "behavioral PHY RX FIFO depth"
	default 8
	range 2 32
	help
	  Number of complete PSDUs retained between the simulated RX ISR and
	  worker. Frames arriving while this FIFO is full are dropped.

config IEEE802154_NATIVE_SIM_SOCKET_RX_WORKER_DELAY_US
	int "behavioral PHY RX worker delay"
	default 1000
	range 0 1000000
	help
	  Delay between the simulated DMA/FIFO enqueue and stack handoff.

config IEEE802154_NATIVE_SIM_SOCKET_RX_TURNAROUND_US
	int "behavioral PHY RX/TX turnaround"
	default 192
	range 0 1000000
	help
	  Minimum RX re-arm delay after a simulated TX, in microseconds. 192 us
	  is the IEEE 802.15.4 aTurnaroundTime at 2.4 GHz.

config IEEE802154_NATIVE_SIM_SOCKET_RX_DROP_FRAME
	int "behavioral PHY frame number to drop"
	default 0
	range 0 1000000
	help
	  Drop exactly this one received frame number. Zero disables the fault.

config IEEE802154_NATIVE_SIM_SOCKET_RX_DROP_EVERY_N
	int "behavioral PHY periodic RX drop"
	default 0
	range 0 1000000
	help
	  Drop every Nth received frame. Zero disables the fault. This is applied
	  after the exact-frame fault and before FIFO-overflow handling.

endif # IEEE802154_NATIVE_SIM_SOCKET_BEHAVIORAL_PHY

endif # IEEE802154_NATIVE_SIM_SOCKET
```

## drivers/ieee802154/Kconfig.phy6252
```kconfig
# SPDX-FileCopyrightText: Copyright The Zephyr Project Contributors
# SPDX-License-Identifier: Apache-2.0

menuconfig IEEE802154_PHY6252
	bool "Phyplus PHY6252 IEEE 802.15.4 radio"
	default y
	depends on DT_HAS_PHYPLUS_PHY6252_RADIO_ENABLED
	help
	  Enable the experimental IEEE 802.15.4 radio driver for Phyplus PHY6252.
	  The RF register setup is based on an unverified PHY6222/PHY6252 backend.

if IEEE802154_PHY6252

config IEEE802154_PHY6252_INIT_PRIO
	int "PHY6252 IEEE 802.15.4 initialization priority"
	default 80

endif # IEEE802154_PHY6252
```

## drivers/ieee802154/Kconfig.stm32wb
```kconfig
# SPDX-FileCopyrightText: Copyright The Zephyr Project Contributors
# SPDX-License-Identifier: Apache-2.0

menuconfig IEEE802154_STM32WB
	bool "STM32WB IEEE 802.15.4 driver (Thread RCP firmware on CPU2)"
	default y
	depends on DT_HAS_ST_STM32WB_IEEE802154_ENABLED
	select USE_STM32_HAL_CORTEX
	help
	  Radio driver for the STM32WB5x. CPU2 must run ST's OpenThread RCP firmware
	  (stm32wb5x_Thread_RCP_fw.bin); the driver exchanges HDLC framed Spinel with it over
	  the IPCC Thread channels. It cannot be used together with the Bluetooth driver.

if IEEE802154_STM32WB

config IEEE802154_STM32WB_INIT_PRIO
	int "STM32WB IEEE 802.15.4 initialization priority"
	default 80
	help
	  Initialization priority of the driver, after the kernel and the clock control.

config IEEE802154_STM32WB_RX_STACK_SIZE
	int "Stack size of the RX work queue"
	default 1536

config IEEE802154_STM32WB_RX_PRIORITY
	int "Priority of the RX work queue thread"
	default 2
	help
	  Cooperative priority of the thread that processes what the RCP sends.

config IEEE802154_STM32WB_REQUEST_TIMEOUT_MS
	int "Timeout of a Spinel property request"
	default 100

config IEEE802154_STM32WB_TX_TIMEOUT_MS
	int "Timeout of a frame transmission (CSMA, retries and ACK wait included)"
	default 300

config IEEE802154_STM32WB_MAX_CSMA_BACKOFFS
	int "Maximum number of CSMA-CA backoffs for IEEE802154_TX_MODE_CSMA_CA"
	default 4

endif # IEEE802154_STM32WB
```

## drivers/ieee802154/Kconfig.tlsr8258
```kconfig
# SPDX-FileCopyrightText: Copyright The Zephyr Project Contributors
# SPDX-License-Identifier: Apache-2.0

menuconfig IEEE802154_TELINK_TLSR8258
	bool "Telink TLSR8258 IEEE 802.15.4 RF driver"
	default y
	depends on DT_HAS_TELINK_TLSR8258_ZB_ENABLED
	select NET_PKT_TIMESTAMP if !IEEE802154_RAW_MODE
	select TLSR825X_DMA_IRQ
	help
	  Enable the IEEE 802.15.4 RF driver for the Telink TLSR8258
	  (2.4 GHz O-QPSK, 250 kbit/s).

if IEEE802154_TELINK_TLSR8258

config IEEE802154_TLSR8258_INIT_PRIO
	int "TLSR8258 IEEE 802.15.4 initialization priority"
	default 80

config IEEE802154_TLSR8258_RX_STACK_SIZE
	int "TLSR8258 RX thread stack size"
	default 1024
	help
	  Stack of the thread that hands received frames to the network
	  stack. The L2 receive path runs in it.

config IEEE802154_TLSR8258_RX_PRIO
	int "TLSR8258 RX thread priority"
	default 4
	range 0 NUM_PREEMPT_PRIORITIES
	help
	  Preemptive priority of the RX thread. Keep it above the thread that
	  consumes the frames, so that a frame is handed over as soon as it is
	  received.

config IEEE802154_TLSR8258_TX_WAIT_US
	int "TLSR8258 RF TX wait timeout"
	default 10000
	help
	  Maximum time in microseconds to poll the RF TX done status in direct
	  transmission mode.

config IEEE802154_TLSR8258_TX_DONE_POLL_US
	int "TLSR8258 RF TX done status poll after a missed interrupt"
	default 5000
	help
	  Time in microseconds to keep polling the RF TX status after the TX
	  wait timed out without a TX-done interrupt. Zero reports the timeout
	  immediately. A completion found this way is reported as success only
	  for frames that do not request an ACK.

config IEEE802154_TLSR8258_CCA_RSSI_THRESHOLD
	int "TLSR8258 CCA RSSI threshold in dBm"
	default -50

endif # IEEE802154_TELINK_TLSR8258
```

## drivers/ieee802154/Kconfig.tlsr8269
```kconfig
# SPDX-FileCopyrightText: Copyright The Zephyr Project Contributors
# SPDX-License-Identifier: Apache-2.0

menuconfig IEEE802154_TELINK_TLSR8269
	bool "Telink TLSR8269 IEEE 802.15.4 RF driver"
	default y
	depends on DT_HAS_TELINK_TLSR8269_ZB_ENABLED
	help
	  Enable the IEEE 802.15.4 RF driver for the Telink TLSR8269 (2.4 GHz
	  O-QPSK, 250 kbit/s). ACK, frame filtering and CCA are not implemented.

if IEEE802154_TELINK_TLSR8269

config IEEE802154_TLSR8269_INIT_PRIO
	int "TLSR8269 IEEE 802.15.4 initialization priority"
	default 80

config IEEE802154_TLSR8269_RX_THREAD
	bool "TLSR8269 RX thread"
	default y
	help
	  Hand received frames to the network stack from a dedicated thread.
	  Disable it to save its stack and thread object: the application then
	  calls tlsr8269_rx_service() from the thread that consumes the frames
	  and wakes it from the function given to tlsr8269_rx_set_notify().

config IEEE802154_TLSR8269_RX_STACK_SIZE
	int "TLSR8269 RX thread stack size"
	default 1024
	depends on IEEE802154_TLSR8269_RX_THREAD
	help
	  Stack of the thread that hands received frames to the network
	  stack. The L2 receive path runs in it.

config IEEE802154_TLSR8269_RX_PRIO
	int "TLSR8269 RX thread priority"
	default 4
	range 0 NUM_PREEMPT_PRIORITIES
	depends on IEEE802154_TLSR8269_RX_THREAD
	help
	  Preemptive priority of the RX thread. Keep it above the thread that
	  consumes the frames, so that a frame is handed over as soon as it is
	  received.

endif # IEEE802154_TELINK_TLSR8269
```

## drivers/pinctrl/Kconfig.tlsr8258
```kconfig
# SPDX-License-Identifier: Apache-2.0

config PINCTRL_TELINK_TLSR8258
	bool "Telink TLSR8258 pin controller"
	default y
	depends on DT_HAS_TELINK_TLSR8258_PINCTRL_ENABLED
	help
	  Enable pin configuration support for Telink TLSR8258.
```

## drivers/pinctrl/Kconfig.tlsr8269
```kconfig
# SPDX-FileCopyrightText: Copyright The Zephyr Project Contributors
# SPDX-License-Identifier: Apache-2.0

config PINCTRL_TELINK_TLSR8269
	bool "Telink TLSR8269 pin controller"
	default y
	depends on DT_HAS_TELINK_TLSR8269_PINCTRL_ENABLED
	help
	  Enable pin configuration support for Telink TLSR8269.
```

## drivers/pwm/Kconfig.tlsr8258
```kconfig
# SPDX-FileCopyrightText: Copyright The Zephyr Project Contributors
# SPDX-License-Identifier: Apache-2.0

config PWM_TLSR8258
	bool "Telink TLSR8258 PWM driver"
	default y
	depends on DT_HAS_TELINK_TLSR8258_PWM_ENABLED
	select PINCTRL
	help
	  Enable the Telink TLSR8258 PWM driver. The controller provides six
	  continuous-mode PWM channels (PWM0..PWM5) sharing one clock divider.
```

## drivers/retained_mem/Kconfig.stm32
```kconfig
# SPDX-FileCopyrightText: Copyright The Zephyr Project Contributors
# SPDX-License-Identifier: Apache-2.0

config RETAINED_MEM_STM32_BKP
	bool "STM32 RTC backup register retained memory driver"
	default y
	depends on DT_HAS_ST_STM32_BKP_RETAINED_ENABLED
	help
	  Enable driver for retained memory kept in the RTC backup registers.
```

## drivers/retained_mem/Kconfig.tlsr8258
```kconfig
# SPDX-FileCopyrightText: Copyright The Zephyr Project Contributors
# SPDX-License-Identifier: Apache-2.0

config RETAINED_MEM_TLSR8258_ANALOG
	bool "TLSR8258 analog register retained memory driver"
	default y
	depends on DT_HAS_TELINK_TLSR8258_ANALOG_RETAINED_ENABLED
	depends on SOC_SERIES_TLSR825X_PM
	help
	  Enable driver for retained memory kept in TLSR8258 analog registers.
```

## drivers/serial/Kconfig.tlsr8258
```kconfig
# SPDX-FileCopyrightText: Copyright The Zephyr Project Contributors
# SPDX-License-Identifier: Apache-2.0

config UART_TELINK_TLSR8258
	bool "Telink TLSR8258 UART driver"
	default y
	depends on DT_HAS_TELINK_TLSR8258_UART_ENABLED
	select SERIAL_HAS_DRIVER
	select SERIAL_SUPPORT_INTERRUPT
	select SERIAL_SUPPORT_ASYNC
	select PINCTRL
	help
	  This option enables the UART driver for Telink TLSR8258.

config UART_TLSR8258_DMA
	bool "Telink TLSR8258 UART DMA for the async API"
	default n
	depends on UART_TELINK_TLSR8258 && UART_ASYNC_API
	depends on !IEEE802154_TELINK_TLSR8258
	help
	  Move async UART TX and RX through DMA1 and DMA0 instead of the
	  interrupt-driven FIFO path. The UART DMA completion interrupt shares
	  the DMA IRQ line with the 802.15.4 radio, so this option cannot be
	  enabled together with IEEE802154_TELINK_TLSR8258.
```

## drivers/serial/Kconfig.tlsr8269
```kconfig
# SPDX-FileCopyrightText: Copyright The Zephyr Project Contributors
# SPDX-License-Identifier: Apache-2.0

config UART_TELINK_TLSR8269
	bool "Telink TLSR8269 UART driver"
	default y
	depends on DT_HAS_TELINK_TLSR8269_UART_ENABLED
	select SERIAL_HAS_DRIVER
	select SERIAL_SUPPORT_INTERRUPT
	select PINCTRL
	help
	  This option enables the UART driver for Telink TLSR8269, polled and
	  interrupt-driven. The async API is not implemented.
```

## drivers/spi/Kconfig.tlsr8258
```kconfig
# SPDX-FileCopyrightText: Copyright The Zephyr Project Contributors
# SPDX-License-Identifier: Apache-2.0

config SPI_TELINK_TLSR8258
	bool "Telink TLSR8258 SPI master driver"
	default y
	depends on DT_HAS_TELINK_TLSR8258_SPI_ENABLED
	select PINCTRL
	help
	  Enable the SPI master driver for the Telink TLSR8258 SPI block.
	  Only the single-line, polled, MSB-first master mode is supported.
```

## drivers/timer/Kconfig.tlsr8258_stimer
```kconfig
# Copyright (c) 2024 Telink Semiconductor
# SPDX-License-Identifier: Apache-2.0

config TLSR8258_STIMER
	bool "TLSR8258 system timer"
	depends on SOC_SERIES_TLSR825X
	default y
	depends on DT_HAS_TELINK_TLSR8258_STIMER_ENABLED
```

## drivers/watchdog/Kconfig.tlsr8258
```kconfig
# SPDX-FileCopyrightText: Copyright The Zephyr Project Contributors
# SPDX-License-Identifier: Apache-2.0

config WDT_TLSR8258
	bool "Telink TLSR8258 watchdog driver"
	default y
	depends on DT_HAS_TELINK_TLSR8258_WATCHDOG_ENABLED
	help
	  Enable the timer2-based watchdog of the Telink TLSR8258. Expiry
	  always resets the SoC.
```

## dts/bindings/adc/telink,tlsr8258-adc.yaml
```yaml
# SPDX-FileCopyrightText: Copyright The Zephyr Project Contributors
# SPDX-License-Identifier: Apache-2.0

description: Telink TLSR8258 SAR ADC

compatible: "telink,tlsr8258-adc"

include: adc-controller.yaml

properties:
  "#io-channel-cells":
    const: 1

child-binding:
  description: |
    One miscellaneous-channel input. Pins are selected by their vendor index:
    1..8 are PB0..PB7, 9 is PC4 and 10 is PC5.

  properties:
    zephyr,input-positive:
      type: int
      required: true
      enum:
        - 1
        - 2
        - 3
        - 4
        - 5
        - 6
        - 7
        - 8
        - 9
        - 10
      description: Vendor pin index (1..8 = PB0..PB7, 9 = PC4, 10 = PC5).

    telink,vbat-mode:
      type: boolean
      description: |
        Drive the pin high and sample it as the battery-voltage input (vendor
        VBAT mode). Without it the pin is a plain base-mode input.

io-channel-cells:
  - input
```

## dts/bindings/counter/telink,tlsr8258-timer.yaml
```yaml
# SPDX-FileCopyrightText: Copyright The Zephyr Project Contributors
# SPDX-License-Identifier: Apache-2.0

description: |
  Telink TLSR8258 hardware timer 0, 1 or 2. The timer index is the interrupt
  number: interrupts = <0> selects timer 0, <1> timer 1 and <2> timer 2.
  Timer 2 is used by the watchdog when it is enabled, and timer 0 by IRQ
  offload.

compatible: "telink,tlsr8258-timer"

include: [base.yaml]

properties:
  reg:
    required: true
    description: Base of the timer block (reg_tmr_ctrl at 0x00800620).

  interrupts:
    required: true
    description: Timer index, 0 to 2.

  clock-frequency:
    type: int
    default: 16000000
    description: |
      Timer clock frequency in Hz. The timer counts at the system clock,
      which is 16 MHz with the 16 MHz crystal.
```

## dts/bindings/cpu/telink,tlsr8258-tc32.yaml
```yaml
# SPDX-FileCopyrightText: Copyright The Zephyr Project Contributors
# SPDX-License-Identifier: Apache-2.0

description: Telink TLSR8258 TC32 CPU

compatible: "telink,tlsr8258-tc32"

include: cpu.yaml

properties:
  clocks:
    required: true
    description: |
      System clock of the CPU. Its clock-frequency is the CPU frequency; the
      property of the CPU node itself is not used.
```
